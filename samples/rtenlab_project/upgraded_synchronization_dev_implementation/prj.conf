## CMakeLists.txt
```
# SPDX-License-Identifier: Apache-2.0

cmake_minimum_required(VERSION 3.20.0)

find_package(Zephyr REQUIRED HINTS $ENV{ZEPHYR_BASE})
project(synchronization)

target_sources(app PRIVATE src/main.c
                            src/uart_i2c.c
                            src/battery/battery.c
                            src/sht31.c
                            src/apds9960.c
                            )
```

## prj.conf
```kconfig
CONFIG_STDOUT_CONSOLE=y
# enable to use thread names
CONFIG_THREAD_NAME=y
CONFIG_SCHED_CPU_MASK=y

# For USB.
CONFIG_CONSOLE=y
CONFIG_UART_CONSOLE=y
CONFIG_USB_DEVICE_STACK=y
CONFIG_USB_DEVICE_PRODUCT="Zephyr USB Console"
CONFIG_SERIAL=y
CONFIG_UART_LINE_CTRL=y
CONFIG_UART_INTERRUPT_DRIVEN=y


CONFIG_FPU=y
CONFIG_ADC=y
```

## src/main.c
```c
/* main.c - Hello World demo */

/*
 * Copyright (c) 2012-2014 Wind River Systems, Inc.
 *
 * SPDX-License-Identifier: Apache-2.0
 */

#include <kernel.h>
#include <sys/printk.h>
#include "uart_i2c.h"
#include "battery/battery.h"

/*
 * The hello world demo has two threads that utilize semaphores and sleeping
 * to take turns printing a greeting message at a controlled rate. The demo
 * shows both the static and dynamic approaches for spawning a thread; a real
 * world application would likely use the static approach for both threads.
 */

#define PIN_THREADS (IS_ENABLED(CONFIG_SMP)		  \
		     && IS_ENABLED(CONFIG_SCHED_CPU_MASK) \
		     && (CONFIG_MP_NUM_CPUS > 1))

/* size of stack area used by each thread */
#define STACKSIZE 1024

/* scheduling priority used by each thread */
#define PRIORITY 7

/* delay between greetings (in ms) */
#define SLEEPTIME 500

K_THREAD_STACK_DEFINE(threadA_stack_area, STACKSIZE);
static struct k_thread threadA_data;

/* Timer Declaration start.*/


void my_work_handler(struct k_work* work){
	k_wakeup(&threadA_data);
}

K_WORK_DEFINE(my_work, my_work_handler);


void my_timer_handler(struct k_timer* timer){
	k_work_submit(&my_work);
}

K_TIMER_DEFINE(my_timer, my_timer_handler, NULL);

/* Timer Declaration End.*/


enum tempMode{
	// Period remains 20 mins as the temp. is fluctuating.
	TEMP_FLUCTUATING_MODE,
	// Period equal to 1 mins for the next 60 minutes.
	TEMP_BURST_MODE,
	// Period will be equal to 60 minutes, if the temp is stable.
	TEMP_NORMAL_MODE,
};

enum batteryMode{
	// Battery is above 4 V and the values should not be changed.
	BAT_NORMAL_MODE,
	// Voltage is between (3.7-3.9]. Change the period.
	BAT_LOW_MODE1,
	// Voltage is between (3.5-3.7]. Change the period.
	BAT_LOW_MODE2,
	// Voltage is below 3.4 volts. Change to the maximum period.
	BAT_CRITICAL_MODE,

};


enum timerPeriod{
	TIMER_BURST_PERIOD=1,
	// Period 20 mins.
	BAT_PERIOD_20M=20,
	// Period 30 mins.
	BAT_PERIOD_30M=30,
	// Period 1 hour.
	BAT_PERIOD_1H=60,
	// Period 2 hours.
	BAT_PERIOD_2H=120,
	// Period 3 hours.
	BAT_PERIOD_3H=180,
	BAT_PERIOD_4H = 240,
};



uint8_t check_battery_level(void){
	float batt = battery_sample();
	if(batt >4) return BAT_NORMAL_MODE;
	else if((batt>3.70) && (batt<=4.00)) return BAT_LOW_MODE1;
	else if((batt>3.50) && (batt<=3.70)) return BAT_LOW_MODE2;
	else if(batt<=3.50) return BAT_CRITICAL_MODE;

	return BAT_NORMAL_MODE;
}
/* threadA is a static thread that is spawned automatically */

volatile uint8_t battery_mode;
volatile uint8_t period;


/**
 * @brief  Sets the battery mode variable and also set the producer consumer timer periods depending on the battery level.
 * @note   
 * @retval Curret Battery Mode returned from check_battery_level function. 
 */
int set_battery_mode(void){
	uint8_t new_batt_mode = check_battery_level();
		if(new_batt_mode == BAT_NORMAL_MODE){
			// make the period to the normal values. Prod. -> 20 and Cons. ->40.
			// Wake up all the tasks.
			if(new_batt_mode!=battery_mode)
				k_timer_start(&my_timer,K_MINUTES(BAT_PERIOD_20M), K_MINUTES(BAT_PERIOD_20M));
			
			battery_mode=new_batt_mode;
			return battery_mode;
		}
		if(new_batt_mode == BAT_LOW_MODE1){
			// change the producer period to be equal to 30 mintues and consumer 60 mins.
			// Wakeup all the tasks.
			if(new_batt_mode!=battery_mode)
				k_timer_start(&my_timer,K_MINUTES(BAT_PERIOD_30M), K_MINUTES(BAT_PERIOD_30M));
			battery_mode = new_batt_mode;
			return battery_mode;
		}
		else if(new_batt_mode == BAT_LOW_MODE2){
			// Producer period = 60 mins and consumer = 120 mins.		
			// Do not wake up the LSM and SCD task.
			if(new_batt_mode!=battery_mode)
				k_timer_start(&my_timer,K_MINUTES(BAT_PERIOD_1H), K_MINUTES(BAT_PERIOD_1H));
			battery_mode = new_batt_mode;
			return battery_mode;
		}
		else if(new_batt_mode == BAT_CRITICAL_MODE){
			// Producer period = 240 and consumer 240 mins.
			// Only wake up the SHT31 task.
			if(new_batt_mode!=battery_mode)
				k_timer_start(&my_timer,K_MINUTES(BAT_PERIOD_2H), K_MINUTES(BAT_PERIOD_2H));
			battery_mode = new_batt_mode;
			return battery_mode;
		}
	return -1;
}

void scheduler(void *dummy1, void *dummy2, void *dummy3)
{
	ARG_UNUSED(dummy1);
	ARG_UNUSED(dummy2);
	ARG_UNUSED(dummy3);
	uint8_t consumer_wakeup=0;
	while(1){
		/**
		 * Code Design for the scheduler. 
		 * 1. Battery level checking and changing the timer. 
		 * 2. Depending on the battery level wakeup minimal tasks. 
		 *
		 **/
		int ret = set_battery_mode();
		
		consumer_wakeup^=1;
		if(consumer_wakeup){
			// Wake up the consumer thread.
			;
		}
		k_sleep(K_FOREVER);
	}

}

static inline void timer_period_init(){
	period.producer_period = 20;
	period.consumer_period = 40;
}

void main(void)
{
	enable_uart_console();

	// Enable battery measurement.
	int rc = battery_measure_enable(true);
	if (rc != 0) {
		printk("Failed initialize battery measurement: %d\n", rc);
	}
	
	timer_period_init();

	k_thread_create(&threadA_data, threadA_stack_area,
			K_THREAD_STACK_SIZEOF(threadA_stack_area),
			scheduler, NULL, NULL, NULL,
			PRIORITY, 0, K_FOREVER);
	k_thread_name_set(&threadA_data, "thread_a");

	k_timer_start(&my_timer, K_MINUTES(period.producer_period), K_MINUTES(period.producer_period));
	k_thread_start(&threadA_data);
	k_thread_join(&threadA_data,K_FOREVER);
	return;
}
```

## src/apds9960.c
```c
#include "uart_i2c.h"
#include "apds9960.h"

// apds9960_t apds9960_data;

/**
* FUNCTION: To read the clear, red, blue, and green channel for the Ambient Light Sensing.
*/
void read_als_data(apds9960_t* data){
	uint8_t data_buffer[8];
	// Read the clear channel!
	i2c_burst_read(dev_i2c, APDS_ADDR, APDS_CDATAL, &data_buffer[0], 8);
	data->clear = data_buffer[1] << 8 | data_buffer[0];
	// Read the red channel!
	data->red = data_buffer[3]<<8| data_buffer[2];
	// Read the Green Channel!
	data->green = data_buffer[5] << 8 | data_buffer[4];
    //Read the blue channel!
	data->blue = data_buffer[7] << 8 | data_buffer[6];
	return;
}

/**
* FUNCTION: To read the proximity data_proximity from the sensor. 
*/
void read_proximity_data(apds9960_t* data){
    i2c_reg_read_byte(dev_i2c,APDS_ADDR,APDS_PDATA,&(data->proximity));
    return;
}

/**
* FUNCTION: To enable the apds sensor to collect   from the sensor. 
*/
void enable_apds_sensor(void){
	i2c_reg_write_byte(dev_i2c,APDS_ADDR,APDS_ENABLE, mask(0) | mask(2) | mask(1));			// This command the configure the APDS9960 sensor and enables the proximity and ALS property on the device.
	delay(100);
    return;

}

void print_data_apds(apds9960_t* data){
	printk("Proximity: %d\nClear: %d\t Red: %d\t Green: %d\t Blue: %d\n", 255-data->proximity, data->clear, data->red, data->blue, data->green);
	return;
}
```

## src/apds9960.h
```c
#ifndef _APDS9960_H
#define _APDS9960_H

#include <zephyr.h>
#include <sys/printk.h>

#define mask(x) (1<<x)									// Macro for masking bits.
#define delay(x)    k_sleep(K_MSEC(x))

#define APDS_ADDR 0x39
#define APDS_PDATA 0x9c
#define APDS_CDATAL 0x94
#define APDS_CDATAH 0x95
#define APDS_RDATAL 0x96
#define APDS_RDATAH 0x97
#define APDS_GDATAL 0x98
#define APDS_GDATAH 0x99
#define APDS_BDATAL 0x9A
#define APDS_BDATAH 0x9B
#define APDS_ENABLE 0x80

typedef struct apds_data{
	uint8_t proximity;
	uint16_t clear;
	uint16_t red;
	uint16_t green;
	uint16_t blue;
}apds9960_t;

void read_proximity_data(apds9960_t*);
void read_als_data(apds9960_t*);
void enable_apds_sensor(void);
void print_data_apds(apds9960_t*);

#endif
```

## src/system_setup.c
```c
#include "system_setup.h"
#include "sht31.h"
#include "apds9960.h"

void sht31(void* dummy1, void* dummy2, void* dummy3){
    ARG_UNUSED(dummy1);
    ARG_UNUSED(dummy2);
    ARG_UNUSED(dummy3);
    sht31_t curr, prev;
    float delta=0.0;
    uint32_t curr_timestamp, prev_timestamp;    
    while(1){
        curr_timestamp = k_uptime_get_32();
        read_temp_hum(&curr);
        prev_timestamp = curr_timestamp;
        printk("Hello from the SHT31 thread.\n");
        delta = (curr.temp - prev.temp);
        memcpy(&prev, &curr, sizeof(curr));
        k_sleep(K_FOREVER);
    }

}


void apds9960(void* dummy1, void* dummy2, void* dummy3){
    ARG_UNUSED(dummy1);
    ARG_UNUSED(dummy2);
    ARG_UNUSED(dummy3);
    apds9960_t curr, prev;

    uint32_t curr_timestamp, prev_timestamp;    
    while(1){
        curr_timestamp = k_uptime_get_32();
        read_proximity_data(&curr);
        read_als_data(&curr);
        prev_timestamp = curr_timestamp;
        printk("Hello from the APDS thread.\n");
        k_sleep(K_FOREVER);
    }
}
```

## src/system_setup.h
```c
#ifndef SYS_SETUP_H
#define SYS_SETUP_H

struct k_timer my_timer;
extern void my_timer_handler(struct k_timer*);
void my_work_handler(struct k_work*);

#endif SYS_SETUP_H
```
