## prj.conf
```kconfig
CONFIG_PRINTK=y
CONFIG_I2C=y

CONFIG_I2C_NRFX=y
CONFIG_I2C_0=y
CONFIG_NRFX_TWI=y
CONFIG_NRFX_TWI0=y
CONFIG_NRFX_TWI1=y

CONFIG_USB_DEVICE_PRODUCT="Zephyr USB Console Sample"
CONFIG_USB_DEVICE_STACK=y
CONFIG_USB_UART_CONSOLE=y

CONFIG_UART_INTERRUPT_DRIVEN=y
CONFIG_UART_LINE_CTRL=y
CONFIG_UART_CONSOLE_ON_DEV_NAME="CDC_ACM_0"

CONFIG_FPU=y
```

## src/main.c
```c
/*
 * SPDX-License-Identifier: Apache-2.0
 * Adapted from https://devzone.nordicsemi.com/f/nordic-q-a/70098/i2c-twi-master-config-on-zephyr.
 * Reference library: https://github.com/Sensirion/embedded-i2c-scd4x
 * Adafruit I2C support library: https://github.com/adafruit/Adafruit_BusIO
 * Zephyr I2C documentation: https://docs.zephyrproject.org/latest/reference/peripherals/i2c.html
 */




/**
 * @file: This app intergrates all the sensors of Adafruit_feather_sense board on zephyr OS.
 */





#define FIRE_SCD
#define FIRE_SHT
#define FIRE_LSM
#define FIRE_APDS
#define FIRE_BMP

#ifdef FIRE_APDS
#include "apds9960.h"
void apds9960_fire(apds9960_t* apds9960_data){
	read_proximity_data(apds9960_data);
	read_als_data(apds9960_data);
	print_data_apds(apds9960_data);
	return;
}
#endif

#ifdef FIRE_SCD
#include "scd41.h"
void scd41_fire(scd41_t* scd41_data){
	measure_single_shot(scd41_data);
	printk("Printing SCD41 DATA!!!\n");
	print_data_scd(scd41_data);

}
#endif

#ifdef FIRE_SHT
#include "sht31.h"
void sht31_fire(sht31_t* sht31_data){
	read_temp_hum(sht31_data);
	printk("PRINTING SHT31 DATA!!!\n");
	print_data_sht(sht31_data);
}
#endif

#ifdef FIRE_LSM
#include "lsm6ds33.h"
void lsm6ds33_fire(lsm6ds33_t* lsm6ds33_data){
	read_burst_data(lsm6ds33_data);
	printk("PRINTING LSM6DS33 DATA!!!\n");
	print_data_lsm(lsm6ds33_data);
}
#endif

#ifdef FIRE_BMP
#include "bmp280.h"
void bmp280_fire(bmp280_t* bmp280_data){
	
	bmp_read_press_temp_data(bmp280_data);
	print_data_bmp(bmp280_data);
}
#endif
void main(void){
	// enabling uart_console for zephyr.
	enable_uart_console();

	// configuring the i2c device for communication with the sensor.
	configure_device();

	//struct to store the data measured from the sensor.
	#ifdef FIRE_SCD
	scd41_t scd41_sensor_data;
	get_serial_number();
	#endif

	#ifdef FIRE_SHT
	sht31_t sht31_sensor_data;
	#endif

	#ifdef FIRE_LSM
	lsm6ds33_t lsm6ds33_sensor_data;
	lsm6ds33_init();
	#endif
	
	#ifdef FIRE_APDS
	apds9960_t apds9960_sensor_data;
	enable_apds_sensor();
	#endif

	#ifdef FIRE_BMP
	bmp280_t bmp280_sensor_data;
	read_calibration_registers();
	#endif
	
	// Infinite loop to measure the data from the sensor, every 100ms. Overall latency will be 5103 ms for each loop iteration.
	while(1){
	#ifdef FIRE_SCD
		scd41_fire(&scd41_sensor_data);
		// delay(100);
	#endif
	#ifdef FIRE_SHT
		sht31_fire(&sht31_sensor_data);
		// delay(50);
	#endif
	#ifdef FIRE_LSM
		lsm6ds33_fire(&lsm6ds33_sensor_data);
		// delay(50);
	#endif
	#ifdef FIRE_APDS
		apds9960_fire(&apds9960_sensor_data);
		delay(1000);
	#endif
	#ifdef FIRE_BMP
		bmp280_fire(&bmp280_sensor_data);
		delay(100);
	#endif
	}

	return;
}
```

## src/apds9960.c
```c
#include "uart_i2c.h"
#include "apds9960.h"

apds9960_t apds9960_data;

/**
* FUNCTION: To read the clear, red, blue, and green channel for the Ambient Light Sensing.
*/
void read_als_data(apds9960_t* data){
	uint8_t data_buffer[8];
	// Read the clear channel!
	i2c_burst_read(dev_i2c, APDS_ADDR, APDS_CDATAL, &data_buffer[0], 8);
	data->clear = data_buffer[1] << 8 | data_buffer[0];
	// Read the red channel!
	data->red = data_buffer[3]<<8| data_buffer[2];
	// Read the Green Channel!
	data->green = data_buffer[5] << 8 | data_buffer[4];
    //Read the blue channel!
	data->blue = data_buffer[7] << 8 | data_buffer[6];
	return;
}

/**
* FUNCTION: To read the proximity data_proximity from the sensor. 
*/
void read_proximity_data(apds9960_t* data){
    i2c_reg_read_byte(dev_i2c,APDS_ADDR,APDS_PDATA,&(data->proximity));
    return;
}

/**
* FUNCTION: To enable the apds sensor to collect   from the sensor. 
*/
void enable_apds_sensor(void){
	i2c_reg_write_byte(dev_i2c,APDS_ADDR,APDS_ENABLE, mask(0) | mask(2) | mask(1));			// This command the configure the APDS9960 sensor and enables the proximity and ALS property on the device.
	delay(100);
    return;

}

void print_data_apds(apds9960_t* data){
	printk("Proximity: %d\nClear: %d\t Red: %d\t Green: %d\t Blue: %d\n", 255-data->proximity, data->clear, data->red, data->blue, data->green);
	return;
}
```

## src/apds9960.h
```c
#ifndef _APDS9960_H
#define _APDS9960_H

#include <errno.h>
#include <zephyr.h>
#include <sys/printk.h>

#define mask(x) (1<<x)									// Macro for masking bits.

#define APDS_ADDR 0x39
#define APDS_PDATA 0x9c
#define APDS_CDATAL 0x94
#define APDS_CDATAH 0x95
#define APDS_RDATAL 0x96
#define APDS_RDATAH 0x97
#define APDS_GDATAL 0x98
#define APDS_GDATAH 0x99
#define APDS_BDATAL 0x9A
#define APDS_BDATAH 0x9B
#define APDS_ENABLE 0x80

typedef struct apds_data{
	uint8_t proximity;
	uint16_t clear;
	uint16_t red;
	uint16_t green;
	uint16_t blue;
}apds9960_t;

void read_proximity_data(apds9960_t*);
void read_als_data(apds9960_t*);
void enable_apds_sensor(void);
void print_data_apds(apds9960_t*);

#endif
```

## src/lsm6ds33.c
```c
#include "lsm6ds33.h"


uint16_t LSM6DS_ADDR = 0x6A;															// Address of the Sensor on I2C bus as described by Adafruit website

int16_t data_buffer[7];	// Buffer to hold the 16-bit data for each paramter in gyroscope and accel.
float temperature_sensitivity = 256.0;
float accel_scale_4_G = 0.122;
float gyro_scale_1000_dps = 35.0;



void check_device(void){
	uint8_t device_id=0;
	i2c_reg_read_byte(dev_i2c, LSM6DS_ADDR, 0X0F, &device_id);
	if(device_id == DEV_ID)
		printk("LSM6DS33 device found!\n");
}

/**
 * @FUNCTION: This function sets the CTRL1_XL register on the sensor to get the accel data rate to 104Hz and 4G data range.
 */
void set_acc_data_rate_range(void){
	int ret = i2c_reg_write_byte(dev_i2c, LSM6DS_ADDR, CTRL1_XL, ACC_104_HZ_4G); 	
	if(ret != 0)
		printk("Error while setting the ACC_range!\n");
	return;
}

/**
 * @FUNCTION: This function sets the CTRL2_G register on the sensor to get the accel data rate to 104Hz and 1000dps data range.
 */
void set_gyro_data_rate_range(void){
	int ret = i2c_reg_write_byte(dev_i2c, LSM6DS_ADDR, CTRL2_G, GYRO_104_HZ_1000dps); 	
	if(ret!=0)
		printk("Error while setting the gyro_range!\n");
	return;
}

/**
 * @FUNCTION: This function pools the status of the sensor by reading the status register.
 */
void status_reg(void){
	uint8_t status=0;
	int ret = i2c_reg_read_byte(dev_i2c, LSM6DS_ADDR, STATUS_REG_LSM, &status);
	if(ret!=0)
		printk("Error reading the status of the register\n");
	printk("Status: %d\n", status);
	return;
}

/**
 * @FUNCTION: This function gets the data from the sensor in bursts.
 */
void read_burst_data(lsm6ds33_t *data){
	uint8_t buffer[14];
	i2c_burst_read(dev_i2c, LSM6DS_ADDR, OUT_TEMP_L, &buffer[0], 14);
	for(int i=0; i<13; i+=2){
		data_buffer[i/2] = buffer[i+1] << 8 | buffer[i];
//		printf("data_buffer[%d] = buffer[%d] << 8 | buffer[%d]\n", i/2, i+1, i);
	}
	data->gyroX = data_buffer[1] * gyro_scale_1000_dps *  SENSORS_DPS_TO_RADS/1000.0;
	data->gyroY = data_buffer[2] * gyro_scale_1000_dps *  SENSORS_DPS_TO_RADS/1000.0;
	data->gyroZ = data_buffer[3] * gyro_scale_1000_dps *  SENSORS_DPS_TO_RADS/1000.0;

	data->accelX = data_buffer[4] * accel_scale_4_G * SENSORS_GRAVITY_STANDARD / 1000;
	data->accelY = data_buffer[5] * accel_scale_4_G  *SENSORS_GRAVITY_STANDARD / 1000;
	data->accelZ = data_buffer[6] * accel_scale_4_G  *SENSORS_GRAVITY_STANDARD / 1000;
	return;
}

void print_data_lsm(lsm6ds33_t *data){
	printf("Gyro: %f\t %f\t %f  dps\n",data->gyroX, data->gyroY, data->gyroZ);
	printf("Accel: %f\t %f\t %f\n",data->accelX, data->accelY, data->accelZ);
	return;
}

void lsm6ds33_init(void){
	set_gyro_data_rate_range();
	set_acc_data_rate_range();

}
```

## src/lsm6ds33.h
```c
#ifndef LSM6DS33_H
#define LSM6DS33_H

#include <stdio.h>
#include <zephyr.h>
#include <sys/printk.h>
#include "uart_i2c.h"


#define DEV_ID 105
#define CTRL1_XL 0x10
#define CTRL2_G 0x11
#define STATUS_REG_LSM 0x1E
#define OUT_TEMP_L 0x20
#define OUT_TMP_H 0x21

#define ACC_104_HZ_4G 0x28		// Set gyroscope data rate to 104HZ
#define GYRO_104_HZ_1000dps 0x28	// Set Accel. data rate to 104HZ
// below values can be found on this website: https://github.com/adafruit/Adafruit_Sensor/blob/master/Adafruit_Sensor.h
#define SENSORS_DPS_TO_RADS (0.017453293F)		
#define SENSORS_GRAVITY_STANDARD (9.80665f)




typedef struct lsm6ds33{
	uint16_t temp;
	float gyroX,
		  gyroY,
		  gyroZ, 
		  accelX,
		  accelY,
		  accelZ;
}lsm6ds33_t;

void check_device(void);
void set_acc_data_rate_range(void);
void set_gyro_data_rate_range(void);
void status_reg(void);
void read_burst_data(lsm6ds33_t*);
void print_data_lsm(lsm6ds33_t*);
void lsm6ds33_init(void);
#endif
```

## src/scd41.c
```c
#include "scd41.h"
 

uint16_t SCD41_ADDR = 0x62;		// Address of the Sensor on I2C bus as described by Adafruit website
uint8_t command_to_sensor[NUM_BYTES_TO_SENSOR];



/**
 * FUNCTION: function to get the crc checksum for the output command.
 * Adapted from Sensirion lbrary: https://github.com/Sensirion/embedded-i2c-scd4x
 */
/* calculates 8-Bit checksum with given polynomial */
uint8_t generate_crc(const uint8_t* data, uint16_t count) {
    uint16_t current_byte;
    uint8_t crc = CRC8_INIT;
    uint8_t crc_bit;
    for (current_byte = 0; current_byte < count; ++current_byte) {
    crc ^= (data[current_byte]);
    for (crc_bit = 8; crc_bit > 0; --crc_bit) {
    if (crc & 0x80)
    crc = (crc << 1) ^ CRC8_POLYNOMIAL;
    else
    crc = (crc << 1);
    }
    }
    return crc;
}


/**
 * @FUNCTION: Function to format the output command that needs to be sent to sensor.
 */
void get_formatted_command(uint16_t command){
	//printf("Preparing 0x%x command to the global buffer!!!\n", command);
	command_to_sensor[0] = (uint8_t)((command & 0xFF00) >> 8);
	command_to_sensor[1] = (uint8_t)((command & 0x00FF) >> 0);
	uint8_t crc = generate_crc(&command_to_sensor[0],2);
	command_to_sensor[2] = crc;	
	return;
}


/**
 * @FUNCTION: function to get the serial number of the sensor.
 */
void get_serial_number(void){
	uint8_t data[9];			// temporary buffer to store the data from the sensor.
	uint16_t serial[3];			// buffer to store just the serial number, excluding crc check.
	get_formatted_command((uint16_t)GET_SERIAL_NUMBER);		// prepares output command in a buffer with the CRC check.
	int ret = i2c_write(dev_i2c, &command_to_sensor[0], NUM_BYTES_TO_SENSOR, SCD41_ADDR);	// write the command prepared in the previous function call to the sensor device. 

	if(ret!=0)
		printf("Error while writing to the device: %d\n", ret);
	delay(3);					//wait for 3 Msec for the sensor to process the command.
	ret = i2c_read(dev_i2c, &data[0],9, SCD41_ADDR);		//read the data sent from the sensor including crc checksum bits.

	if(ret !=0)
		printf("Error while reading from the device: %d\n", ret);
	
	// Get the 3 words in different 16 bit entries in serial.
	serial[0] = data[0] <<8 | data[1];
	serial[1] = data[3] << 8 | data[4];
	serial[2] = data[6] << 8 | data[7];

	//print the output data.
	printf("Correct Serial ID: 0x%4X%4X%4X\n",serial[0],serial[1], serial[2]);

	return;
}

/**
 * FUNCTION: function to read the measured data from the sensor.
 */ 
void read_sensor_data(uint8_t *data, int num_bins_to_read){
	// Command to notify sensor requirement of data.
	get_formatted_command((uint16_t)READ_MEASUREMENT);
	i2c_write(dev_i2c, &command_to_sensor[0], NUM_BYTES_TO_SENSOR, SCD41_ADDR);
	delay(3);
	// Read 9 bytes of data. In order: CO2 -> Tempreature -> humidity.
	i2c_read(dev_i2c, data, num_bins_to_read, SCD41_ADDR);
	return;
}

/**
 * FUNCTION: function to measure data once from the sensor.
 */
void measure_single_shot(scd41_t* data){
	// buffers to store the incoming data from the sensor.
	uint8_t data_buffer[9];
	uint16_t format_data=0;
	// Command to notify sensor to measure data just once.
	get_formatted_command((uint16_t)MEASURE_SINGLE_SHOT);
	i2c_write(dev_i2c, &command_to_sensor[0], NUM_BYTES_TO_SENSOR, SCD41_ADDR);
	//delay of 5 sec for the sensor to get data.
	delay(5000);
	// function call to read 9 bytes of data from the sensor.
	read_sensor_data(&data_buffer[0], 9);
	//store the CO2 data coming from the sensor directly to struct.
	data->Co2 = data_buffer[0] <<8 | data_buffer[1];
	// store the tempreature data coming from the sensor with some modifications as per datasheet.
	format_data = data_buffer[3] << 8 | data_buffer[4]; 
	data->temp = (float)(format_data*175.0/65536.0-45.0);
	// store the humidity data coming from the sensor with some modifications as per datasheet.
	format_data = data_buffer[6] << 8 | data_buffer[7];
	data->hum = (float)(format_data*100.0/65536.0);	
	return;
}

/**
 * FUNCTION: function to print the data obtained from the sensor.
 */
void print_data_scd(scd41_t* data){
    	printf("CO2:%d\t Hum:%f\t Temp: %f\n", data->Co2, data->hum, data->temp);
	return;
}
```

## src/scd41.h
```c
#ifndef SCD41_H
#define SCD41_H

#include<stdio.h>
#include <zephyr.h>
#include <sys/printk.h>
#include "uart_i2c.h"

#define CRC8_POLYNOMIAL 0x31
#define CRC8_INIT 0xFF
#define NUM_BYTES_TO_SENSOR 3
#define READ_MEASUREMENT 0xec05
#define GET_SERIAL_NUMBER 0x3682
#define MEASURE_SINGLE_SHOT 0x219d



// data structure to get the data from the sensor.										
typedef struct data{
	uint16_t Co2;
	float temp, hum;
}scd41_t;


// defining the functions used in the main.c file.
uint8_t generate_crc(const uint8_t*, uint16_t);
void enable_uart_console(void);
void configure_device(void);
void get_formatted_command(uint16_t);
void get_serial_number(void);
void read_sensor_data(uint8_t*, int);
void measure_single_shot(scd41_t*);
void print_data_scd(scd41_t*);
#endif
```

## src/sht31.c
```c
#include "sht31.h"

const struct device *dev_i2c;														// Device struct to get device binding for I2C
uint16_t SHT31_ADDR = 0x44;																		// Address of the Sensor on I2C bus as described by Adafruit website



/**
* @FUNCTION: API to write commands to the sensor using i2c_write() API provided in zephyr.
*/
void write_command(uint16_t command){
	//Convert 16 bit data address into chunk of two 8-bit data address and write to I2C in burst mode.
	uint8_t cmd[2];
	cmd[0] = command>>8;
	cmd[1] = command & 0xFF;
	int ret = i2c_write(dev_i2c, &cmd[0], 2, SHT31_ADDR);
	if(ret){
		printk("WRITE UNSUCCESSFULL!!\n");
	}
	return;
}

/**
* @FUNCTION: API to read the status of the SHT31 Address. It will return 16 bit data from sensor.
*/
uint16_t read_status(void){
	int ret;
	uint8_t data[2];
	uint16_t status;
	// Give command to read the status register.
	write_command(STATUS_REG_SHT);
	// Read the I2C device to get status register data.
	ret = i2c_read(dev_i2c, &data[0], 2, SHT31_ADDR);
		if(ret)
			printf("Unsuccessful Read attempt\n");

	//Manipulate the data to convert the 2 chunks of 8-bit data into 16-bit data.
	status = data[0];
	status <<= 8;
	status |= data[1];
	return status;
}

/**
* @FUNCTION: API to read the temperature and humidity data from SHT31 Sensor. All data is global so no input 
*/
void read_temp_hum(sht31_t *var){
	uint8_t read_buffer[6];
	write_command(HIGH_MEAS_CLOCK_ENABLE);
	k_sleep(K_MSEC(50));
	int ret = i2c_read(dev_i2c, &read_buffer[0], 6, SHT31_ADDR);
	if(ret){
		printk("ret:%d \n",ret);
		printk("UnSUCESSFUL READ TEMPREATURE AND HUMIDITY\n");
	}
		
	int32_t stemp = (int32_t)(((uint32_t)read_buffer[0] << 8) | read_buffer[1]);
	stemp = ((4375 * stemp) >> 14) - 4500;
	var->temp = (float)stemp/100.0f;

	uint32_t shum = ((uint32_t)read_buffer[3] << 8) | read_buffer[4];
	shum = (625 * shum) >> 12;
	var->humidity = (float)shum/100.0f;
	return;
}

void print_data_sht(sht31_t* data){
    printk("Temp: %f\t Humidity: %f\n",data->temp,data->humidity);
    return;
}
```

## src/sht31.h
```c
#ifndef SHT31_H
#define SHT31_H

#include<stdio.h>
#include <zephyr.h>
#include <sys/printk.h>
#include "uart_i2c.h"


	
#define mask(x) (1<<x)																				// Macro for masking bits.


#define STATUS_REG_SHT 0xF32D
#define ENABLE_HEATER 0x306D
#define SOFT_RESET 0x30A2
#define HIGH_MEAS_CLOCK_ENABLE 0x2C06
#define MED_MEAS_CLOCK_ENABLE 0x2C0D
#define LOW_MEAS_CLOCK_ENABLE 0x2C10
#define HIGH_MEAS_CLOCK_DIS 0X2400
#define MED_MEAS_CLOCK_DIS 0x240B
#define LOW_MEAS_CLOCK_DIS 0x2416




// Struct to hold the integer and fractional information of temperature and humidity.
typedef struct temphum{
	float temp;
	float humidity;
}sht31_t;


void enable_uart_console(void);
void configure_device(void);
void write_command(uint16_t);
uint16_t read_status(void);
void read_temp_hum(sht31_t*);
void print_data_sht(sht31_t*);

#endif
```

## src/uart_i2c.h
```c
#ifndef UART_I2C_H
#define UART_I2C_H 

#include <device.h>
#include <drivers/i2c.h>
#include <usb/usb_device.h>
#include <drivers/uart.h>

extern const struct device *dev_i2c;
#define delay(x) k_sleep(K_MSEC(x))

void enable_uart_console(void);
void configure_device(void);

#endif
```
