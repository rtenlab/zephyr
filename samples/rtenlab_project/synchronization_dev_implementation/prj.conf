## CMakeLists.txt
```
# SPDX-License-Identifier: Apache-2.0

cmake_minimum_required(VERSION 3.13.1)

find_package(Zephyr REQUIRED HINTS $ENV{ZEPHYR_BASE})
project(synchronization)

target_sources(app PRIVATE src/main.c
                            src/bmp280.c)
```

## prj.conf
```kconfig
CONFIG_STDOUT_CONSOLE=y
# enable to use thread names
CONFIG_THREAD_NAME=y
CONFIG_SCHED_CPU_MASK=y


CONFIG_USB_DEVICE_PRODUCT="Zephyr USB Console Sample"
CONFIG_USB_DEVICE_STACK=y
CONFIG_USB_UART_CONSOLE=y

CONFIG_UART_INTERRUPT_DRIVEN=y
CONFIG_UART_LINE_CTRL=y
CONFIG_UART_CONSOLE_ON_DEV_NAME="CDC_ACM_0"

CONFIG_PRINTK=y
CONFIG_I2C=y

CONFIG_I2C_NRFX=y
CONFIG_I2C_0=y
CONFIG_NRFX_TWI=y
CONFIG_NRFX_TWI0=y
CONFIG_NRFX_TWI1=y  

CONFIG_FPU=y

# enable to use thread names
CONFIG_SEGGER_SYSTEMVIEW=y
# CONFIG_USE_SEGGER_RTT=y
CONFIG_TRACING=y
#Tracing
CONFIG_SEGGER_SYSTEMVIEW_BOOT_ENABLE=y
# careful adjustment as long as there is enough SRAM use it for tracing 128 KB
CONFIG_SEGGER_SYSVIEW_RTT_BUFFER_SIZE=131072


CONFIG_GEN_SW_ISR_TABLE=y

CONFIG_BT=y
CONFIG_BT_PERIPHERAL=y
# CONFIG_BT_DEBUG_LOG=y
# CONFIG_BT_SMP=y
CONFIG_TINYCRYPT=y
CONFIG_BT_DEVICE_NAME="BUZZ Project Inner Board"
CONFIG_BT_DIS=y
CONFIG_BT_DIS_PNP=n
CONFIG_BT_DEVICE_APPEARANCE=769
```

## src/main.c
```c
/* Multi-threading Code for HoneyBee Monitoring System */

/*
 * Author: Dev Joshi
 * Email Id: djosh011@ucr.edu
 * 
 */

// #include "uart_i2c.c"
#include <zephyr.h>
#include <sys/printk.h>
#include <errno.h>

#include"setup_defines.h"
#include "ble_setup.c"



volatile uint8_t stable_temperature = 0;
volatile bool is_period_changed = false;
volatile uint8_t producer_timer_period = 4;
volatile uint8_t consumer_timer_period = 21;


/*
 * The hello world demo has two threads that utilize semaphores and sleeping
 * to take turns printing a greeting message at a controlled rate. The demo
 * shows both the static and dynamic approaches for spawning a thread; a real
 * world application would likely use the static approach for both threads.
 */

#define PIN_THREADS (IS_ENABLED(CONFIG_SMP)		  \
		     && IS_ENABLED(CONFIG_SCHED_CPU_MASK) \
		     && (CONFIG_MP_NUM_CPUS > 1))



/* scheduling priority used by each thread */
#define PRIORITY 7

struct k_mutex mymutex, tempvalue;

#ifdef SHT31

void sht31(void *dummy1, void *dummy2, void *dummy3)
{
	ARG_UNUSED(dummy1);
	ARG_UNUSED(dummy2);
	ARG_UNUSED(dummy3);
	/* invoke routine to ping-pong hello messages with threadB */
	struct k_thread *current_thread;
	current_thread = k_current_get();
	ble_data_t sht31_local_data;
	sht31_local_data.type = SENSOR_SHT31;
	static uint32_t prev_timestamp, curr_timestamp;
	while(1){
		k_mutex_lock(&mymutex, K_FOREVER);
		curr_timestamp = k_uptime_get_32();
		sht31_local_data.period = (curr_timestamp-prev_timestamp)/1000.00;
		prev_timestamp=curr_timestamp;
		read_temp_hum(&sht31_local_data.sht31_data);
		printk("[%f] Hello from %s\n", sht31_local_data.period,k_thread_name_get(current_thread));
		k_msgq_put(&my_msgq, &sht31_local_data, K_FOREVER);
		if(sht31_local_data.sht31_data.temp >= SWARMING_TEMP_THRESHOLD){
			k_mutex_lock(&tempvalue, K_FOREVER);
			stable_temperature |= (1<<SHT31_POS);
			k_mutex_unlock(&tempvalue);
		}
		printk("SHT Ended!!!\n");
		k_mutex_unlock(&mymutex);
		k_sleep(K_FOREVER);
	}
	return;
}
#endif

#ifdef BMP280

void bmp280(void* dummy1, void* dummy2, void* dummy3){
	ARG_UNUSED(dummy1);
	ARG_UNUSED(dummy2);
	ARG_UNUSED(dummy3);
	read_calibration_registers();
	struct k_thread *current_thread;
	current_thread = k_current_get();
	ble_data_t bmp280_local_data;
	bmp280_local_data.type = SENSOR_BMP280;
	static uint32_t prev_timestamp, curr_timestamp;
	while(1){
		k_mutex_lock(&mymutex, K_FOREVER);
		curr_timestamp=k_uptime_get_32();
		bmp280_local_data.period = (curr_timestamp-prev_timestamp)/1000.00;
		prev_timestamp = curr_timestamp;
		bmp_read_press_temp_data(&bmp280_local_data.bmp280_data);
		printk("[%f] Hello from %s\n", bmp280_local_data.period,k_thread_name_get(current_thread));
		k_msgq_put(&my_msgq, &bmp280_local_data, K_FOREVER);
		if(bmp280_local_data.bmp280_data.temperature>=SWARMING_TEMP_THRESHOLD){
			k_mutex_lock(&tempvalue, K_FOREVER);
			stable_temperature |= (1<<BMP280_POS);
			k_mutex_unlock(&tempvalue);
		}
		printk("BMP Ended!!!\n");
		k_mutex_unlock(&mymutex);
		k_sleep(K_FOREVER);
	}
}
#endif



#ifdef APDS9960
void apds9960(void *dummy1, void *dummy2, void *dummy3)
{
	ARG_UNUSED(dummy1);
	ARG_UNUSED(dummy2);
	ARG_UNUSED(dummy3);
	struct k_thread *current_thread;
	// apds9960_t threadC_apds9960;
	current_thread = k_current_get();
	// Write something to start another sensor.
	ble_data_t apds_local_data;
	apds_local_data.type = SENSOR_APDS9960;
	static uint32_t prev_timestamp, curr_timestamp;
	while(1){
		k_mutex_lock(&mymutex, K_FOREVER);
		curr_timestamp = k_uptime_get_32();
		apds_local_data.period = (curr_timestamp-prev_timestamp)/1000.00;
		prev_timestamp = curr_timestamp;
		read_proximity_data(&apds_local_data.apds_cls_data);
		read_als_data(&apds_local_data.apds_cls_data);
		printk("[%f] Hello from %s\n", apds_local_data.period,k_thread_name_get(current_thread));
		k_msgq_put(&my_msgq, &apds_local_data, K_FOREVER);
		printk("APDS Ended!!!\n");
		k_mutex_unlock(&mymutex);
		k_sleep(K_FOREVER);
	}	
	return;
}
#endif



#ifdef LSM6DS33

void lsm6ds33(void* dummy1, void* dummy2, void* dummy3){
	ARG_UNUSED(dummy1);
	ARG_UNUSED(dummy2);
	ARG_UNUSED(dummy3);
	struct k_thread* current_thread;
	current_thread = k_current_get();
	ble_data_t lsm6ds33_local_data;
	lsm6ds33_local_data.type = SENSOR_LSM6DS33;
	static uint32_t prev_timestamp, curr_timestamp;
	float accelX, accelY, accelZ;	
	float totalX, totalY, totalZ;
	uint8_t count;
	// Initialize the sensor by setting necessary parameters for gyroscope and accelerometer
	accel_set_power_mode(ACCEL_LOW_POWER_MODE);
	gyro_set_power_mode(GYRO_LOW_POWER_MODE);
	//  Check if the FIFO_FULL Flag is set or not.
	while(1){
		// Mutex is locked for very long time. Need to make sure how to do this.
		printk("LSM: Waiting for Mutex\n");
		// while (1) {
		// 	// k_mutex_lock(&mymutex, K_FOREVER);
		// 	// if (lsm6ds33_fifo_status() & FIFO_FULL) == 0) {
		// 	// 	k_mutex_unlock(&mymutex);
		// 	// 	sleep(xx); // for some time or
		// 	// 	or k_yield(); // relinquish CPU
		// 	// }
		// 	// else break;
		// }
		k_mutex_lock(&mymutex, K_FOREVER);
		curr_timestamp = k_uptime_get_32();
		lsm6ds33_local_data.period = (curr_timestamp-prev_timestamp)/1000.00;
		prev_timestamp = curr_timestamp;
		printk("[%f] Hello from %s\n", lsm6ds33_local_data.period,k_thread_name_get(current_thread));
		printk("Waiting for the FIFO mode to get the data...\n");
		while((lsm6ds33_fifo_status() & FIFO_FULL) == 0) { };
		count=0, totalX=0, totalY=0, totalZ=0;
		while( (lsm6ds33_fifo_status()& FIFO_EMPTY) == 0){
			accelX = lsm6ds33_fifo_get_accel_data(lsm6ds33_fifo_read());
			totalX+=accelX;
			accelY = lsm6ds33_fifo_get_accel_data(lsm6ds33_fifo_read());
			totalY+=accelY;
			accelZ = lsm6ds33_fifo_get_accel_data(lsm6ds33_fifo_read());
			totalZ+=accelZ;
			count++;
		}
		printk("Average X: %f\t Y: %f\t Z: %f\n", totalX/count, totalY/count, totalZ/count);
		lsm6ds33_local_data.lsm6ds33_data.accelX = totalX/count;
		lsm6ds33_local_data.lsm6ds33_data.accelY = totalY/count;
		lsm6ds33_local_data.lsm6ds33_data.accelZ = totalZ/count;
		k_msgq_put(&my_msgq, &lsm6ds33_local_data, K_FOREVER);
		lsm6ds33_fifo_change_mode(0);
		k_sleep(K_FOREVER);
		k_mutex_unlock(&mymutex);
		printk("LSM6DS33 Finished!!!\n");
		lsm6ds33_fifo_change_mode(1);
	}
}
#endif

char* enum_to_string(ble_data_t* data){
	if(data->type == SENSOR_APDS9960){
		return "APDS9960";
	}
	else if(data->type == SENSOR_SHT31){
		return "SHT31";
	}
	else if(data->type == SENSOR_BMP280){
		return "BMP280";
	}
	else if(data->type == SENSOR_LSM6DS33){
		return "LSM6DS33";
	}
	
	return "Not Valid";
}



void consumer_thread(void* dummy1, void* dummy2, void* dummy3)
{
	ARG_UNUSED(dummy1);
	ARG_UNUSED(dummy2);
	ARG_UNUSED(dummy3);
	ble_data_t consumer_local_data;
	uint32_t time=0;
	printk("Consumer Thread: Entered for the first time!!!\n");
	while(1){
		led_on_blink1(true);
		uint8_t num_used = k_msgq_num_used_get(&my_msgq);
		for(int i=0; i<num_used; i++){
			int8_t ret = k_msgq_get(&my_msgq, &consumer_local_data, K_MSEC(100));
			if(ret!=0){
				printk("Couldn't find data\n");
			}
			time = k_cycle_get_32();
			if(consumer_local_data.type == SENSOR_APDS9960){
				printk("[Current: %d\t Period: %f] Data type: %s\t Prox: %d\t Clear: %d\t Red: %d\t Blue: %d\t Green: %d\n",
													time,
													consumer_local_data.period,
													enum_to_string(&consumer_local_data),
													consumer_local_data.apds_cls_data.proximity, 
														consumer_local_data.apds_cls_data.clear, 
														consumer_local_data.apds_cls_data.red,
														consumer_local_data.apds_cls_data.blue, 
														consumer_local_data.apds_cls_data.green);
#ifdef BLE
				// Add code to send it through BLE.
				bt_gatt_notify(NULL, &ess_svc.attrs[APDS_BLE_HANDLE], &consumer_local_data.apds_cls_data.clear, sizeof(consumer_local_data.apds_cls_data.clear));
#endif
			}
			else if(consumer_local_data.type == SENSOR_SHT31){
				// printk("[Current: %d\t Period: %f] Data type: %s\t Temp: %f\t Humi: %f\n",
													// time, 
													// consumer_local_data.period,
													// enum_to_string(&consumer_local_data),
														// consumer_local_data.sht31_data.temp, 
														// consumer_local_data.sht31_data.humidity);
				int16_t temp_value, hum_value;
				temp_value = (uint16_t)((consumer_local_data.sht31_data.temp)*100);
				hum_value = (uint16_t)((consumer_local_data.sht31_data.humidity)*100);
#ifdef BLE				
				bt_gatt_notify(NULL, &ess_svc.attrs[SHT_TEMP_BLE_HANDLE], &temp_value, sizeof(temp_value));
				// delay(100);
				bt_gatt_notify(NULL, &ess_svc.attrs[SHT_HUM_BLE_HANDLE], &hum_value, sizeof(hum_value));
#endif
			}

			else if(consumer_local_data.type == SENSOR_BMP280){
				printk("[Current: %d\t Period: %f] Data type: %s\t Temp: %f\t Press: %f\n",
													time, 
													consumer_local_data.period,
													enum_to_string(&consumer_local_data),
														consumer_local_data.bmp280_data.temperature, 
														consumer_local_data.bmp280_data.pressure);
				static uint16_t temperature;
				temperature = (uint16_t)((consumer_local_data.bmp280_data.temperature)*100);
				static uint32_t pressure;
				pressure = (uint32_t)((consumer_local_data.bmp280_data.pressure)*10);
#ifdef BLE
				bt_gatt_notify(NULL, &ess_svc.attrs[BMP_TEMP_BLE_HANDLE], &temperature, sizeof(temperature));
				// delay(100);
				bt_gatt_notify(NULL, &ess_svc.attrs[BMP_PRESS_BLE_HANDLE], &pressure, sizeof(pressure));
#endif 
			}

			else if(consumer_local_data.type == SENSOR_LSM6DS33){
				printk("[Current: %d\t Period: %f] Data type: %s\t AccelX: %f\t AccelY: %f\t AccelZ: %f\n",
													time, 
													consumer_local_data.period,
													enum_to_string(&consumer_local_data),
														consumer_local_data.lsm6ds33_data.accelX, 
														consumer_local_data.lsm6ds33_data.accelY,
														consumer_local_data.lsm6ds33_data.accelZ);
				static int16_t finalX, finalY, finalZ;
				finalX = (int16_t)((consumer_local_data.lsm6ds33_data.accelX)*100+32768);
				finalY = (int16_t)((consumer_local_data.lsm6ds33_data.accelY)*100+32768);
				finalZ = (int16_t)((consumer_local_data.lsm6ds33_data.accelZ)*100+32768);
#ifdef BLE
				bt_gatt_notify(NULL, &ess_svc.attrs[LSM_ACCELX_BLE_HANDLE], &finalX, sizeof(finalX));
				// delay(100);
				bt_gatt_notify(NULL, &ess_svc.attrs[LSM_ACCELY_BLE_HANDLE], &finalY, sizeof(finalY));
				// delay(100);
				bt_gatt_notify(NULL, &ess_svc.attrs[LSM_ACCELZ_BLE_HANDLE], &finalZ, sizeof(finalZ));
#endif
			}
			
		}// End of if.
		led_on_blink1(false);
		k_sleep(K_FOREVER);

	}

}


void temperature_checker_thread(void* dummy1, void* dummy2, void* dummy3){
	ARG_UNUSED(dummy1);
	ARG_UNUSED(dummy2);
	ARG_UNUSED(dummy3);
	bool is_period_changed = false;
	uint8_t mins_since_counter_changed=0;
	while(1){
		// Period is not changed in last 60 minutes. Check if we are before swarming effect.
		if(is_period_changed == false){
			// Lock the mutex to read the stable_temperature value. Many threads might be 
			// changing this at the same time.
			k_mutex_lock(&tempvalue, K_FOREVER);
			if((stable_temperature == 7) || (stable_temperature == 11) || 
				(stable_temperature == 13) || (stable_temperature == 14) ||
				(stable_temperature == 15)){
					k_mutex_unlock(&tempvalue);
					// Change the following values according to the needs. 
					// This will start a new timer with new producer and consumer period values.
					producer_timer_period = 2;
					consumer_timer_period = 4;
					k_timer_start(&producer_timer, K_SECONDS(producer_timer_period), K_SECONDS(producer_timer_period));
				#ifdef CONSUMER
					k_timer_start(&consumer_timer, K_SECONDS(consumer_timer_period), K_SECONDS(consumer_timer_period));
				#endif
					is_period_changed=true;
					mins_since_counter_changed=0;
			}
		}
		// The period for both the threads was changed and hence we should count the number 
		// of times the data was taken before we change the is_period_changed to false.
		else{
			// Considering that the period was set to every minute, we should get the data
			// for 60 minutes (hence once we have a trigger, we will take data every minute
			// for 60 minutes).
			mins_since_counter_changed++;
			if(mins_since_counter_changed >=60){
				is_period_changed=false;
				// Change the values to what the period values previously where. This variable is not needed.
				producer_timer_period = 4;
				consumer_timer_period = 6;
				// Start the timers again, basically will change the period for both the timers.
				k_timer_start(&producer_timer, K_SECONDS(producer_timer_period), K_SECONDS(producer_timer_period));
			#ifdef CONSUMER
				k_timer_start(&consumer_timer, K_SECONDS(consumer_timer_period), K_SECONDS(consumer_timer_period));
			#endif
			}
			
		}
		// Wait until one of the threads wake you up.
		k_sleep(K_FOREVER);
	}

}



void main(void)
{
	// This will configure the I2C device so this is necessary.
	configure_device();
#ifdef UART  
	enable_uart_console();
#endif
	k_mutex_init(&mymutex);
	k_mutex_init(&tempvalue);
	printk("Number of CPUS: %d\n", CONFIG_MP_NUM_CPUS);

#ifdef BLE
	// code to turn on the bluetooth module and start advertisement.
	int err = bt_enable(NULL);
	if (err) {
		printk("Bluetooth init failed (err %d)\n", err);
		return;
	}
	bt_ready();
	bt_conn_cb_register(&conn_callbacks);
#endif

#ifdef SHT31
	k_thread_create(&sht31_thread_data, sht31_stack_area,
			K_THREAD_STACK_SIZEOF(sht31_stack_area),
			sht31, NULL, NULL, NULL,
			PRIORITY, 0, K_NO_WAIT);
	k_thread_name_set(&sht31_thread_data, "SHT_Thread");
#endif
#ifdef APDS9960
	enable_apds_sensor();
	k_thread_create(&apds9960_thread_data, apds9960_stack_area, 
			K_THREAD_STACK_SIZEOF(apds9960_stack_area),
			apds9960, NULL, NULL, NULL, 
			PRIORITY-4, 0, K_MSEC(20));
	k_thread_name_set(&apds9960_thread_data, "APDS Thread");
#endif

#ifdef BMP280
	k_thread_create(&bmp280_thread_data, bmp280_stack_area, 
		K_THREAD_STACK_SIZEOF(bmp280_stack_area),
		bmp280, NULL, NULL, NULL, 
		PRIORITY, 0, K_MSEC(40));
	k_thread_name_set(&bmp280_thread_data, "BMP Thread");
#endif

#ifdef LSM6DS33
	lsm6ds33_init();
	k_thread_create(&lsm6ds33_thread_data, lsm6ds33_stack_area, 
		K_THREAD_STACK_SIZEOF(lsm6ds33_stack_area),
		lsm6ds33, NULL, NULL, NULL, 
		PRIORITY, 0, K_MSEC(60));
	k_thread_name_set(&lsm6ds33_thread_data, "LSM Thread");
#endif

#ifdef CONSUMER
	k_thread_create(&consumer_thread_data, consumer_stack_area,
			K_THREAD_STACK_SIZEOF(consumer_stack_area),
			consumer_thread, NULL, NULL, NULL,
			PRIORITY-3, 0, K_MSEC(80));
	k_thread_name_set(&consumer_thread_data, "Consumer_Thread");
#endif 

#ifdef Temperature_check
	k_thread_create(&temperature_checker_thread_data, temperature_checker_stack_area,
		K_THREAD_STACK_SIZEOF(temperature_checker_stack_area),
		temperature_checker_thread, NULL, NULL, NULL,
		PRIORITY, 0, K_MSEC(100));
		k_thread_name_set(&temperature_checker_thread_data, "Temperature_Checker_Thread");
#endif
	k_timer_start(&producer_timer, K_SECONDS(producer_timer_period), K_SECONDS(producer_timer_period));
#ifdef CONSUMER
	k_timer_start(&consumer_timer, K_SECONDS(consumer_timer_period), K_SECONDS(consumer_timer_period));
#endif


}
```

## src/ble_setup.c
```c
#include <bluetooth/bluetooth.h>
#include <bluetooth/hci.h>
#include <bluetooth/conn.h>
#include <bluetooth/uuid.h>
#include <bluetooth/gatt.h>
#include <usb/usb_device.h>
#include "blink.c"
#define BLE_SHT31
#define BLE_APDS9960
#define BLE_BMP280
#define BLE_LSM6DS33

// Defines to get the format of the data sent using custom characteristics UUID
#define CPF_FORMAT_UINT8 	0x04
#define CPF_FORMAT_UINT16 	0x06
#define CPF_FORMAT_UINT32	0x08

// Defines to get the unitsof the data sent using custom characteristics UUID

#define CPF_UNIT_NO_UNIT 	0x2700
#define CPF_UNIT_METER 		0x2701
#define CPF_UNIT_ACCEL 		0x2713
#define CPF_UNIT_ANG_VEL	0x2743
#define CPF_UNIT_ELEC_RES		0x272A
#define CPF_VOLTAGE_UNIT	0x2B18

#define SHT_TEMP_BLE_HANDLE 1		// 1
#define SHT_HUM_BLE_HANDLE (SHT_TEMP_BLE_HANDLE+3)  // 4
#define APDS_BLE_HANDLE (SHT_HUM_BLE_HANDLE+4)		// 8
#define BMP_TEMP_BLE_HANDLE (APDS_BLE_HANDLE+5)     // 13
#define BMP_PRESS_BLE_HANDLE (BMP_TEMP_BLE_HANDLE+3)  // 16
#define LSM_ACCELX_BLE_HANDLE (BMP_PRESS_BLE_HANDLE+4) //20
#define LSM_ACCELY_BLE_HANDLE (LSM_ACCELX_BLE_HANDLE+4) //24
#define LSM_ACCELZ_BLE_HANDLE (LSM_ACCELY_BLE_HANDLE+4) //28


volatile bool BLE_isConnected = false;
volatile bool notif_enabled = false;


#ifdef BLE_SHT31

// @brief 57812a99-9146-4e72-a4b7-5159632dee90
static struct bt_uuid_128 sht_uuid = BT_UUID_INIT_128(
		BT_UUID_128_ENCODE(0x57812a99, 0x9146, 0x4e72, 0Xa4b7,  0X5159632dee90));

#endif

#ifdef BLE_APDS9960

// @brief  UUID for apds sensor data: ebcc60b7-974c-43e1-a973-426e79f9bc6c 
static struct bt_uuid_128 apds_uuid = BT_UUID_INIT_128(
		BT_UUID_128_ENCODE(0xebcc60b7, 0x974c, 0x43e1, 0Xa973,  0X426e79f9bc6c));

// 	@brief  UUID for clear_als apds sensor data: e960c9b7-e0ed-441e-b22c-d93252fa0fc6

static struct bt_uuid_128 apds_als_clear_uuid = BT_UUID_INIT_128(
		BT_UUID_128_ENCODE(0xe960c9b7, 0xe0ed, 0x441e, 0xb22c, 0xd93252fa0fc6));

#endif

#ifdef BLE_BMP280

static struct bt_uuid_128 bmp280_primary_uuid = BT_UUID_INIT_128(
		BT_UUID_128_ENCODE(0xf4356abe, 0xb85f, 0x47c7, 0xab4e, 0x54df8f4ad025));
#endif

#ifdef BLE_LSM6DS33

//@brief  UUID for clear_als apds sensor data: e82bd800-c62c-43d5-b03f-c7381b38892a
static struct bt_uuid_128 lsm6ds33_primary_uuid = BT_UUID_INIT_128(
	BT_UUID_128_ENCODE(0xe82bd800, 0xc62c, 0x43d5, 0xb03f, 0xc7381b38892a));

//@brief  UUID for clear_als apds sensor data: 461d287d-1ccd-46bf-8498-60139deeeb27
static struct bt_uuid_128 lsm6ds33_accl_x_uuid = BT_UUID_INIT_128(
		BT_UUID_128_ENCODE(0x461d287d, 0x1ccd, 0x46bf, 0x8498, 0x60139deeeb27));


//@brief  UUID for clear_als apds sensor data: a32f4917-d566-4273-b435-879eb85bd5cd
static struct bt_uuid_128 lsm6ds33_accl_y_uuid = BT_UUID_INIT_128(
		BT_UUID_128_ENCODE(0xa32f4917, 0xd566, 0x4273, 0xb435, 0x879eb85bd5cd));

//@brief  UUID for clear_als apds sensor data: e6837dcc-ff0b-4329-a271-c3269c61b10d
static struct bt_uuid_128 lsm6ds33_accl_z_uuid = BT_UUID_INIT_128(
	BT_UUID_128_ENCODE(0xe6837dcc, 0xff0b, 0x4329, 0xa271, 0xc3269c61b10d));

#endif


static void hrmc_ccc_cfg_changed(const struct bt_gatt_attr *attr, uint16_t value)
{
	ARG_UNUSED(attr);
	notif_enabled = (value == BT_GATT_CCC_NOTIFY);
}



#ifdef BLE_APDS9960

/**
 * @brief  Struct bt_gatt_cpf to construct the charactersitics presentation format.
 * @note   ALS data is 16 bits long and the unit is not specified in the data sheet.
 */
static const struct bt_gatt_cpf als = {
	.format = CPF_FORMAT_UINT16,
	.unit = CPF_UNIT_NO_UNIT,
};

#endif

#ifdef BLE_LSM6DS33
/**
 * @brief  Struct bt_gatt_cpf to construct the charactersitics presentation format.
 * @note   Accelerometer data is 16 bits long and the unit is m/s^2.
 */
static const struct bt_gatt_cpf accel = {
	.format = CPF_FORMAT_UINT16,
	.unit = CPF_UNIT_ACCEL,
};

#endif



BT_GATT_SERVICE_DEFINE(ess_svc,
// Primary Service for SHT Sensor. Basically Tempearture and sensor value.
#ifdef BLE_SHT31
	BT_GATT_PRIMARY_SERVICE(&sht_uuid),
// Caharactersitic temp. value. attrs[1]
	BT_GATT_CHARACTERISTIC(BT_UUID_TEMPERATURE, BT_GATT_CHRC_NOTIFY,
			       BT_GATT_PERM_READ, NULL, NULL, NULL),
	BT_GATT_CCC(hrmc_ccc_cfg_changed,
		    BT_GATT_PERM_READ | BT_GATT_PERM_WRITE),

// charactersitic humidity value. attrs[4]
	BT_GATT_CHARACTERISTIC(BT_UUID_HUMIDITY, BT_GATT_CHRC_NOTIFY,
					BT_GATT_PERM_READ, NULL, NULL, NULL),

	BT_GATT_CCC(hrmc_ccc_cfg_changed,
		    BT_GATT_PERM_READ | BT_GATT_PERM_WRITE),
#endif

#ifdef BLE_APDS9960
// Primary Service for APDS9960 sensor.
	BT_GATT_PRIMARY_SERVICE(&apds_uuid),

// Characteristic blue_als data value and descriptors for unit and format. attr[8]
	BT_GATT_CHARACTERISTIC(&apds_als_clear_uuid.uuid, BT_GATT_CHRC_NOTIFY,
					BT_GATT_PERM_READ, NULL, NULL, NULL),
	BT_GATT_CCC(hrmc_ccc_cfg_changed,
			BT_GATT_PERM_READ | BT_GATT_PERM_WRITE),
	BT_GATT_CPF(&als),
#endif

#ifdef BLE_BMP280
	BT_GATT_PRIMARY_SERVICE(&bmp280_primary_uuid),
// Caharactersitic temp. value. attrs[13]
	BT_GATT_CHARACTERISTIC(BT_UUID_TEMPERATURE, BT_GATT_CHRC_NOTIFY,
			       BT_GATT_PERM_READ, NULL, NULL, NULL),
	BT_GATT_CCC(hrmc_ccc_cfg_changed,
		    BT_GATT_PERM_READ | BT_GATT_PERM_WRITE),

// charactersitic humidity value. attrs[16]
	BT_GATT_CHARACTERISTIC(BT_UUID_PRESSURE, BT_GATT_CHRC_NOTIFY,
					BT_GATT_PERM_READ, NULL, NULL, NULL),
	BT_GATT_CCC(hrmc_ccc_cfg_changed,
		    BT_GATT_PERM_READ | BT_GATT_PERM_WRITE),
#endif

#ifdef BLE_LSM6DS33
	BT_GATT_PRIMARY_SERVICE(&lsm6ds33_primary_uuid),
// Characteristic green_als data value and descriptors for unit and format. attr[20]
	BT_GATT_CHARACTERISTIC(&lsm6ds33_accl_x_uuid.uuid, BT_GATT_CHRC_NOTIFY,
					BT_GATT_PERM_READ, NULL, NULL, NULL),
	BT_GATT_CCC(hrmc_ccc_cfg_changed,
			BT_GATT_PERM_READ | BT_GATT_PERM_WRITE),
	BT_GATT_CPF(&accel),

// Characteristic blue_als data value and descriptors for unit and format. attr[24]
	BT_GATT_CHARACTERISTIC(&lsm6ds33_accl_y_uuid.uuid, BT_GATT_CHRC_NOTIFY,
					BT_GATT_PERM_READ, NULL, NULL, NULL),
	BT_GATT_CCC(hrmc_ccc_cfg_changed,
			BT_GATT_PERM_READ | BT_GATT_PERM_WRITE),
	BT_GATT_CPF(&accel),

// Characteristic blue_als data value and descriptors for unit and format. attr[28]
	BT_GATT_CHARACTERISTIC(&lsm6ds33_accl_z_uuid.uuid, BT_GATT_CHRC_NOTIFY,
					BT_GATT_PERM_READ, NULL, NULL, NULL),
	BT_GATT_CCC(hrmc_ccc_cfg_changed,
			BT_GATT_PERM_READ | BT_GATT_PERM_WRITE),
	BT_GATT_CPF(&accel),

#endif
);


static const struct bt_data ad[] = {
	BT_DATA_BYTES(BT_DATA_FLAGS, (BT_LE_AD_GENERAL | BT_LE_AD_NO_BREDR)),
	BT_DATA_BYTES(BT_DATA_UUID16_ALL,
		      BT_UUID_16_ENCODE(BT_UUID_ESS_VAL)),
};

static void connected(struct bt_conn *conn, uint8_t err)
{
	BLE_isConnected=true;
	printk("_isConnected set to: %d\n", BLE_isConnected);
	if (err) {
		printk("Connection failed (err 0x%02x)\n", err);
	} else {
		printk("Connected\n");
	}
	// Turn off the LED to notify we are connected!
	led_on_blink1(false);
	// Stop advertising once we are connected.
	// if(bt_le_adv_stop() != 0){
	// 	printk("Couldn't stop advertising. Sorry\n");
	// }
}

static void disconnected(struct bt_conn *conn, uint8_t reason)
{
	BLE_isConnected=false;
	notif_enabled=false;
	printk("_isConnected set to: %d\n", BLE_isConnected);
	// Not sure if this is needed!
	int8_t err = bt_conn_disconnect(conn, 0x08);
	if(err){
		printk("Disconnected call returned with %d\n", err);
	}
	err = bt_le_adv_start(BT_LE_ADV_CONN_NAME, ad, ARRAY_SIZE(ad), NULL, 0);
	if(err){
		printk("Advertising failed to start (err %d)\n", err);
	}
	printk("Disconnected (reason 0x%02x)\n", reason);
	// Turn ON the LED to notify we are not connected!
	led_on_blink1(true);
}

static struct bt_conn_cb conn_callbacks = {
	.connected = connected,
	.disconnected = disconnected,
};

static void bt_ready(void)
{
	int err;

	printk("Bluetooth initialized\n");

	err = bt_le_adv_start(BT_LE_ADV_CONN_NAME, ad, ARRAY_SIZE(ad), NULL, 0);
	if (err) {
		printk("Advertising failed to start (err %d)\n", err);
		return;
	}
	printk("Advertising successfully started\n");
	// Start the LED immediately to signal it is not connected right now.
	led_on_blink1(true);
}
```

## src/blink.c
```c
/*
 * Copyright (c) 2016 Intel Corporation
 *
 * SPDX-License-Identifier: Apache-2.0
 */

#include <zephyr.h>
#include <device.h>
#include <devicetree.h>
#include <drivers/gpio.h>

/* 1000 msec = 1 sec */
#define SLEEP_TIME_MS   1000

/* The devicetree node identifier for the "led0" alias. */
#define LED0_NODE DT_ALIAS(led0)

#if DT_NODE_HAS_STATUS(LED0_NODE, okay)
#define LED0	DT_GPIO_LABEL(LED0_NODE, gpios)
#define PIN	DT_GPIO_PIN(LED0_NODE, gpios)
#define FLAGS	DT_GPIO_FLAGS(LED0_NODE, gpios)
#else
/* A build error here means your board isn't set up to blink an LED. */
#error "Unsupported board: led0 devicetree alias is not defined"
#define LED0	""
#define PIN	0
#define FLAGS	0
#endif

/* The devicetree node identifier for the "led0" alias. */
#define LED1_NODE DT_ALIAS(led1)

#if DT_NODE_HAS_STATUS(LED1_NODE, okay)
#define LED1	DT_GPIO_LABEL(LED1_NODE, gpios)
#define LED1_PIN	DT_GPIO_PIN(LED1_NODE, gpios)
#define LED1_FLAGS	DT_GPIO_FLAGS(LED1_NODE, gpios)
#else
/* A build error here means your board isn't set up to blink an LED. */
#error "Unsupported board: led0 devicetree alias is not defined"
#define LED0	""
#define PIN	0
#define FLAGS	0
#endif


/* The devicetree node identifier for the "led0" alias. */
#define TOGGLE_NODE DT_ALIAS(toggle0)

#if DT_NODE_HAS_STATUS(TOGGLE_NODE, okay)
#define TOGGLE	DT_GPIO_LABEL(TOGGLE_NODE, gpios)
#define TOGGLE_PIN	DT_GPIO_PIN(TOGGLE_NODE, gpios)
#define TOGGLE_FLAGS	DT_GPIO_FLAGS(TOGGLE_NODE, gpios)
#else
/* A build error here means your board isn't set up to blink an LED. */
#error "Unsupported board: led0 devicetree alias is not defined"
#define TOGGLE	""
#define TOGGLE_PIN	0
#define TOGGLE_FLAGS	0
#endif



void led_on_blink0(bool flag)
{
	const struct device *dev;
	int ret;

	dev = device_get_binding(LED0);
	if (dev == NULL) {
		return;
	}

	ret = gpio_pin_configure(dev, PIN, GPIO_OUTPUT_ACTIVE | FLAGS);
	if (ret < 0) {
		return;
	}

	gpio_pin_set(dev, PIN, (int)flag);
}


void led_on_blink1(bool flag)
{
	const struct device *dev;
	int ret;

	dev = device_get_binding(LED1);
	if (dev == NULL) {
		return;
	}

	ret = gpio_pin_configure(dev, LED1_PIN, GPIO_OUTPUT_ACTIVE | LED1_FLAGS);
	if (ret < 0) {
		return;
	}

	gpio_pin_set(dev, LED1_PIN, (int)flag);
}

void toggle_pin_D9(bool flag)
{
	const struct device *dev;
	int ret;

	dev = device_get_binding(TOGGLE);
	if (dev == NULL) {
		return;
	}

	ret = gpio_pin_configure(dev, TOGGLE_PIN, GPIO_OUTPUT_ACTIVE | TOGGLE_FLAGS);
	if (ret < 0) {
		return;
	}

	gpio_pin_set(dev, TOGGLE_PIN, (int)flag);
}
```

## src/bmp280.c
```c
#include "bmp280.h"

uint8_t calib_data[2];																				// dump array of registers to burst read the 16 bit calib data.
uint16_t calib_data_unsigned_registers[2];										//Contains dig_T1 and dig_P1 register.
int16_t calib_data_signed_registers[10];											// Containes dig_T2,T3 and dig_[P2-P9] registers.
uint8_t calib_signed_registers[10]= {0x8A,0x8C,0x90,0x92,
						0x94,0x96,0x98,0x9A,0x9C,0x9E};										// Register address to get the calibaration data.
uint8_t calib_unsigned_registers[2] = {0x88,0x8E};						// Register address to get the unsigned calibration data.

uint8_t temp_data[3];																					// Array to hold the raw temperature data.
uint8_t press_data[3];																				// Array to hold the raw pressure data.
uint32_t temperature, pressure;																// 32 bit variable to convert the 20 bit data from the array of registers to a single variable

int32_t t_fine;


uint8_t check_sensor(void){
    uint8_t temp;
    i2c_reg_read_byte(dev_i2c,BMP280_ADDR,REG_ID,&temp);															
	if(temp==0x58){
		printk("Bosch BMP280 Found!\n");
        return 1;
    }
    else{
        printk("BMP280 Sensor Not Found!\n");
        return 0;
    }
}

void read_calibration_registers(void){
	#ifdef BMP_DEBUG
	printk("I\t calib[0]\t calib[1]\t final_temperature\t Register\n");
	#endif

	// For loop tp get the unsigned data dig_T1 and dig_P1.
	for(int i=0;i<2;i++){
	i2c_burst_read(dev_i2c,BMP280_ADDR,calib_unsigned_registers[i],&calib_data[0],2);
	calib_data_unsigned_registers[i] = ((uint16_t)((uint16_t)(calib_data[1]))<<8 | ((uint16_t)(calib_data[0])));
	#ifdef BMP_DEBUG
	printk("%d\t %d\t %d\t %d\t %x\n",i,calib_data[0],calib_data[1],calib_data_unsigned_registers[i],calib_unsigned_registers[i]);
	#endif
	calib_data[0]=0;calib_data[1]=0;
	}

	// For loop to get the signed data dig_T2-T3 and dig_P[2-9].
	for(int i=0;i<10;i++){
	i2c_burst_read(dev_i2c,BMP280_ADDR,calib_signed_registers[i],&calib_data[0],2);
	calib_data_signed_registers[i] = ((int16_t)((int16_t)(calib_data[1]))<<8 | ((int16_t)(calib_data[0])));
	#ifdef BMP_DEBUG
	printk("%d\t %d\t %d\t %d\t %x\n",i,calib_data[0],calib_data[1],calib_data_signed_registers[i],calib_signed_registers[i]);
	#endif
	calib_data[0]=0;calib_data[1]=0;
	}
}



int32_t temperature_read_raw_data(void){
	int32_t rawdata;
	i2c_burst_read(dev_i2c,BMP280_ADDR,0xFA,&temp_data[0],3);		// Burst read the temperature data.
	rawdata = (int32_t) ((((uint32_t) (temp_data[0])) << 12) | (((uint32_t) (temp_data[1])) << 4) | ((uint32_t) temp_data[2] >> 4));
	// return uint32_t(temp_data[0])<<16 | uint32_t(temp_data[1])<<8 | uint32_t(temp_data[2]);
	return rawdata;		
}
float read_temperature(void){
    i2c_reg_write_byte(dev_i2c,BMP280_ADDR,REG_CTRL_MEAS,START_READING_DATA);

	int32_t var1, var2;

	int32_t temp = temperature_read_raw_data();

	var1 = ((((temp >> 3) - ((int32_t)calib_data_unsigned_registers[0] << 1))) * ((int32_t) calib_data_signed_registers[0])) >>11;

	var2 = (((((temp >> 4) - ((int32_t) calib_data_unsigned_registers[0])) * ((temp >> 4) - ((int32_t)calib_data_unsigned_registers[0]))) >> 12) * ((int32_t) calib_data_signed_registers[1])) >> 14;
	t_fine = var1+var2;

	float T = (t_fine  * 5 + 128) >>8;
	return T/100;
}


/**
*	FUNCTION: To get the raw data of pressure.
*/
int32_t pressure_read_raw_data(void){
	int32_t rawdata;
	i2c_burst_read(dev_i2c, BMP280_ADDR, 0xF7, &press_data[0],3);
	rawdata = (int32_t) ((((uint32_t) (press_data[0])) << 12) | (((uint32_t) (press_data[1])) << 4) | ((uint32_t) press_data[2] >> 4));
	return rawdata;
}

/**
* FUNCTION: To convert the raw data into human readable format. Adapted from the adafruit library.
*/

float read_pressure(void){
	int64_t var1, var2, p;
	read_temperature();																			// Required to get the t_fine variable.
	int32_t press = pressure_read_raw_data();

	var1 = ((int64_t)t_fine) - 128000;

	var2 = var1 * var1 *(int64_t) calib_data_signed_registers[6];
	var2 = var2 + ((var1 * (int64_t) calib_data_signed_registers[5]) << 17);
	var2 = var2 + (((int64_t) calib_data_signed_registers[4]) << 35);
	var1 = ((var1 * var1 * (int64_t)calib_data_signed_registers[3]) >> 8) + 
					((var1 * (int64_t)calib_data_signed_registers[2]) << 12);

	var1 = (((((int64_t)1) << 47) + var1)) * ((int64_t)calib_data_unsigned_registers[1]) >> 33;

	if(var1 == 0)
		return 0;

	p = 1048576 - press;
	p = (((p<<31) - var2) * 3125) / var1;
	var1 = (((int64_t)calib_data_signed_registers[9]) * (p >> 13) * (p >> 13)) >> 25;
	var2 = (((int64_t)calib_data_signed_registers[8]) * p) >> 19;

	p = ((p + var1 + var2) >> 8) + (((int64_t) calib_data_signed_registers[7]) << 4);
	return (float)p/256;
}

void bmp_read_press_temp_data(bmp280_t* bmp280_sensor_data_temp){
    bmp280_sensor_data_temp->temperature = read_temperature();
    bmp280_sensor_data_temp->pressure = read_pressure();
    return;
}

void print_data_bmp(bmp280_t* bmp280_sensor_data_temp){
    printk("Tempreature data: %f\t Pressure: %f\n",bmp280_sensor_data_temp->temperature,bmp280_sensor_data_temp->pressure); 
}
```

## src/bmp280.h
```c
#ifndef BMP280_H
#define BMP280_H

#include <zephyr.h>
#include <sys/printk.h>
#include <stdio.h>
#include "uart_i2c.h"
#include <stdlib.h>
#include <kernel.h>


#define I2C_DEV "I2C_0"

#define BMP280_ADDR 0x77
#define REG_SENSOR_ID 0x58
#define REG_ID 0xD0
#define REG_RESET 0xE0
#define STATUS_REG_BMP 0xF3
#define REG_CTRL_MEAS 0xF4
#define REG_CONFIG 0xF5
#define REG_PRESSURE_MSB 0xF7
    #define REG_PRESSURE_LSB 0xF8
    #define REG_PRESSURE_XLSB 0xF9  // (bit 7,6,5,4)
#define REG_TEMP_MSB 0xFA
    #define REG_TEMP_LSB 0xFB
    #define REG_TEMP_XLSB 0xFC  // (bit 7,6,5,4)
// #define BMP_DEBUG
/**
* [7:5] READING TEMP. SAMPLING X16
* [4:2] READING PRESS SAMPLING X16
* [1:0] SENSOR POWER MODE- FORCED MODE.
*/
#define START_READING_DATA 0XB6     //10110110. 

typedef struct{
    float temperature;
    float pressure;
}bmp280_t;


/**
* Checks the Sensor ID and make sure the sensor is BMP280.
*
* @returns:(uint8_t): 0, if the sensor is correct, 1 otherwise.
*/
uint8_t check_sensor(void);


/**
* Read the calibration register values from the sensor. Values remains constant.
*/
void read_calibration_registers(void);

/**
* Helper function to get the RAW data of the temperature sensor directly from the registers.
* @returns: The raw temperature in signed 32 bit-integer.
*/
int32_t temperature_read_raw_data(void);

/**
* Reads the temperature data and converts the data into human-readable form.
* @returns: Float value of the human-readable format. 
*/
float read_temperature(void);

/**
* Reads the pressure raw data from the registers. 
* @returns: Signed integer number to get the pressure value directly from the register.
*/
int32_t pressure_read_raw_data(void);

/**
* Reads the pressure data and converts it to human readable form.
* @returns: Float value of the human-readable format. 
*/
float read_pressure(void); 


void bmp_read_press_temp_data(bmp280_t*);


void print_data_bmp(bmp280_t*);



#endif
```

## src/lsm6ds33.c
```c
#include "lsm6ds33.h"

const struct device *dev_i2c;															// Device struct to get device binding for I2C
uint16_t LSM6DS_ADDR = 0x6A;															// Address of the Sensor on I2C bus as described by Adafruit website

int16_t data_buffer[7];	// Buffer to hold the 16-bit data for each paramter in gyroscope and accel.
float temperature_sensitivity = 256.0;
float accel_scale_4_G = 0.122;
float gyro_scale_1000_dps = 35.0;



void check_device(void){
	uint8_t device_id=0;
	i2c_reg_read_byte(dev_i2c, LSM6DS_ADDR, 0X0F, &device_id);
	if(device_id == DEV_ID)
		printk("LSM6DS33 device found!\n");
}

/**
 * @FUNCTION: This function sets the CTRL1_XL register on the sensor to get the accel data rate to 104Hz and 4G data range.
 */
void set_acc_data_rate_range(void){
	int ret = i2c_reg_write_byte(dev_i2c, LSM6DS_ADDR, CTRL1_XL, ACC_104_HZ_4G); 	
	if(ret != 0)
		printk("Error while setting the ACC_range!\n");
	return;
}

/**
 * @FUNCTION: This function sets the CTRL2_G register on the sensor to get the accel data rate to 104Hz and 1000dps data range.
 */
void set_gyro_data_rate_range(void){
	int ret = i2c_reg_write_byte(dev_i2c, LSM6DS_ADDR, CTRL2_G, GYRO_104_HZ_1000dps); 	
	if(ret!=0)
		printk("Error while setting the gyro_range!\n");
	return;
}

/**
 * @FUNCTION: This function pools the status of the sensor by reading the status register.
 */
void status_reg(void){
	uint8_t status=0;
	int ret = i2c_reg_read_byte(dev_i2c, LSM6DS_ADDR, STATUS_REG_LSM, &status);
	if(ret!=0)
		printk("Error reading the status of the register\n");
	printk("Status: %d\n", status);
	return;
}

/**
 * @FUNCTION: This function gets the data from the sensor in bursts.
 */
void read_burst_data(lsm6ds33_t *data){
	uint8_t buffer[14];
	i2c_burst_read(dev_i2c, LSM6DS_ADDR, OUT_TEMP_L, &buffer[0], 14);
	for(int i=0; i<13; i+=2){
		data_buffer[i/2] = buffer[i+1] << 8 | buffer[i];
//		printf("data_buffer[%d] = buffer[%d] << 8 | buffer[%d]\n", i/2, i+1, i);
	}
	data->gyroX = data_buffer[1] * gyro_scale_1000_dps *  SENSORS_DPS_TO_RADS/1000.0;
	data->gyroY = data_buffer[2] * gyro_scale_1000_dps *  SENSORS_DPS_TO_RADS/1000.0;
	data->gyroZ = data_buffer[3] * gyro_scale_1000_dps *  SENSORS_DPS_TO_RADS/1000.0;

	data->accelX = data_buffer[4] * accel_scale_4_G * SENSORS_GRAVITY_STANDARD / 1000;
	data->accelY = data_buffer[5] * accel_scale_4_G  *SENSORS_GRAVITY_STANDARD / 1000;
	data->accelZ = data_buffer[6] * accel_scale_4_G  *SENSORS_GRAVITY_STANDARD / 1000;
	return;
}

void print_data(lsm6ds33_t *data){
	printf("Gyro: %f\t %f\t %f  dps\n",data->gyroX, data->gyroY, data->gyroZ);
	printf("Accel: %f\t %f\t %f\n",data->accelX, data->accelY, data->accelZ);
	return;
}

void lsm6ds33_init(void){
	set_gyro_data_rate_range();
	set_acc_data_rate_range();

}
```

## src/lsm6ds33.h
```c
#ifndef LSM6DS33_H
#define LSM6DS33_H

#include <stdio.h>
#include <zephyr.h>
#include <sys/printk.h>
#include "uart_i2c.h"


#define DEV_ID 105
#define CTRL1_XL 0x10
#define CTRL2_G 0x11
#define STATUS_REG_LSM 0x1E
#define OUT_TEMP_L 0x20
#define OUT_TMP_H 0x21
#define delay(x) k_sleep(K_MSEC(x))

#define ACC_104_HZ_4G 0x28		// Set gyroscope data rate to 104HZ
#define GYRO_104_HZ_1000dps 0x28	// Set Accel. data rate to 104HZ
// below values can be found on this website: https://github.com/adafruit/Adafruit_Sensor/blob/master/Adafruit_Sensor.h
#define SENSORS_DPS_TO_RADS (0.017453293F)		
#define SENSORS_GRAVITY_STANDARD (9.80665f)




typedef struct lsm6ds33{
	uint16_t temp;
	float gyroX,
		  gyroY,
		  gyroZ, 
		  accelX,
		  accelY,
		  accelZ;
}lsm6ds33_t;

void enable_uart_console(void);
void configure_device(void);
void check_device(void);
void set_acc_data_rate_range(void);
void set_gyro_data_rate_range(void);
void status_reg(void);
void read_burst_data(lsm6ds33_t*);
void print_data(lsm6ds33_t*);
void lsm6ds33_init(void);
#endif
```

## src/scd41.h
```c
#ifndef SCD41_H
#define SCD41_H

#include<stdio.h>
#include <zephyr.h>
#include <sys/printk.h>
#include "uart_i2c.h"

#define CRC8_POLYNOMIAL 0x31
#define CRC8_INIT 0xFF
#define NUM_BYTES_TO_SENSOR 3
#define READ_MEASUREMENT 0xec05
#define GET_SERIAL_NUMBER 0x3682
#define MEASURE_SINGLE_SHOT 0x219d
#define delay(x) k_sleep(K_MSEC(x))


// data structure to get the data from the sensor.										
typedef struct data{
	uint16_t Co2;
	float temp, hum;
}scd41_t;


// defining the functions used in the main.c file.
uint8_t generate_crc(const uint8_t*, uint16_t);
void enable_uart_console(void);
void configure_device(void);
void get_formatted_command(uint16_t);
void get_serial_number(void);
void read_sensor_data(uint8_t*, int);
void measure_single_shot(scd41_t*);
void print_data_scd(scd41_t*);
#endif
```

## src/setup_defines.h
```c
#ifndef __SETUP_DEFINES_H_
#define __SETUP_DEFINES_H_
#include "sht31.c"
#include "uart_i2c.c"
#include "lsm6ds33.c"
#include "apds9960.c"
#include "scd41.c"
#include "bmp280.h"

// THREAD DEFINES
#define SHT31
#define UART
// #define LSM6DS33
// #define APDS9960
// #define SCD41
// #define BMP280
#define BLE
#define CONSUMER
/* size of stack area used by each thread */
#define STACKSIZE 1024

#define SHT31_POS 0
#define SCD41_POS 1
#define BMP280_POS 2
#define DS18B20_POS 3

#define SWARMING_TEMP_THRESHOLD 20



#ifdef SHT31
K_THREAD_STACK_DEFINE(sht31_stack_area, STACKSIZE);
static struct k_thread sht31_thread_data;
#endif
#ifdef APDS9960
K_THREAD_STACK_DEFINE(apds9960_stack_area, STACKSIZE);
static struct k_thread apds9960_thread_data;
#endif

#ifdef BMP280
K_THREAD_STACK_DEFINE(bmp280_stack_area, STACKSIZE);
static struct k_thread bmp280_thread_data;
#endif

#ifdef LSM6DS33
K_THREAD_STACK_DEFINE(lsm6ds33_stack_area, STACKSIZE);
static struct k_thread lsm6ds33_thread_data;
#endif

#ifdef CONSUMER
K_THREAD_STACK_DEFINE(consumer_stack_area, STACKSIZE);
static struct k_thread consumer_thread_data;
#endif

K_THREAD_STACK_DEFINE(temperature_checker_stack_area, STACKSIZE);
static struct k_thread temperature_checker_thread_data;

// THREAD DEFINES END


// Let's first define message queue.
#define MSGQ_LENGTH 8
#define MSGQ_BYTE_BOUNDARY 4

// Enumeration to use inside the new struct ble_data_t. This enum will give names\
	to different type of sensor data	
enum data_type{
	SENSOR_SHT31,
	SENSOR_APDS9960,
	SENSOR_BMP280,
	SENSOR_LSM6DS33,
	SENSOR_SCD41,
	SENSOR_DS18B20,
};

/**
 * @brief  Struct to define the data structure used for data passing between threads.
 */
typedef struct {
	enum data_type type;
	float period;
	union 
	{
		// scd41_t scd41_data;
		sht31_t sht31_data;
		lsm6ds33_t lsm6ds33_data;
		bmp280_t bmp280_data;
		apds9960_t apds_cls_data;
		// int16_t ds18b20_temp_data;
	};
}ble_data_t;

/* Create a MSG Queue for the threads to use for data passing*/
K_MSGQ_DEFINE(my_msgq, sizeof(ble_data_t), MSGQ_LENGTH, MSGQ_BYTE_BOUNDARY);


// END OF MESSAGE QUEUE DEFINES



/***WORKQ defines:***/
/**
 * @brief  Work Handler function. This will be ran by a thread in backend depending on the priority.
 * @note   
 * @param  struct k_work*: What wok needs to be done.
 * @retval None
 */
void producer_work_handler(struct k_work *work){
#ifdef SHT31
	k_wakeup(&sht31_thread_data);
#endif
#ifdef APDS9960
	k_wakeup(&apds9960_thread_data);
#endif
#ifdef BMP280
	k_wakeup(&bmp280_thread_data);
#endif
#ifdef LSM6DS33
	k_wakeup(&lsm6ds33_thread_data);
#endif
}

void consumer_work_handler(struct k_work * work){
	k_wakeup(&consumer_thread_data);
}
// Define a work and it's work handler
K_WORK_DEFINE(producer_work, producer_work_handler);
K_WORK_DEFINE(consumer_work, consumer_work_handler);

/** WORKQ DEFINES END**/

/*** TIMER DEFINES ***/
// Define a function that will be called when a timer expires.
void producer_timer_handler(struct k_timer* dummy){
	k_work_submit(&producer_work);
}

void consumer_timer_handler(struct k_timer* dummy){
	k_work_submit(&consumer_work);
}

// Define a timer.
K_TIMER_DEFINE(producer_timer, producer_timer_handler, NULL);
K_TIMER_DEFINE(consumer_timer, consumer_timer_handler, NULL);

/*** TIMER DEFINES END ***/

#endif
```
