## prj.conf
```kconfig
CONFIG_PRINTK=y
CONFIG_I2C=y

CONFIG_I2C_NRFX=y
CONFIG_I2C_0=y
CONFIG_NRFX_TWI=y
CONFIG_NRFX_TWI0=y
CONFIG_NRFX_TWI1=y

CONFIG_USB_DEVICE_PRODUCT="Zephyr USB Console Sample"
CONFIG_USB_DEVICE_STACK=y
CONFIG_USB_UART_CONSOLE=y

CONFIG_UART_INTERRUPT_DRIVEN=y
CONFIG_UART_LINE_CTRL=y
CONFIG_UART_CONSOLE_ON_DEV_NAME="CDC_ACM_0"

CONFIG_FPU=y
```

## src/main.c
```c
/*
 * SPDX-License-Identifier: Apache-2.0
 * Adapted from https://devzone.nordicsemi.com/f/nordic-q-a/70098/i2c-twi-master-config-on-zephyr.
 * Adafruit LSM6DS Library: https://github.com/adafruit/Adafruit_LSM6DS
 * Adafruit I2C support library: https://github.com/adafruit/Adafruit_BusIO
 * Zephyr I2C documentation: https://docs.zephyrproject.org/latest/reference/peripherals/i2c.html
 */




/**
 * @file: This app enables the use of LSM6DS33 sensor on zephyr OS.
 */
#include "lsm6ds33.h"

// #define SINGLE_SHOT_MODE
#define FIFO_MODE

void main(void){
	lsm6ds33_t lsm6ds33_sensor_data;
	// enabling uart_console for zephyr.
	enable_uart_console();

	// configuring the i2c device for communication with the sensor.
	configure_device();

	// check if we have t he sensor we want.
	check_device();

	// Initialize the sensor by setting necessary parameters for gyroscope and accelerometer
	lsm6ds33_init();

	accel_set_power_mode(ACCEL_LOW_POWER_MODE);
	gyro_set_power_mode(GYRO_LOW_POWER_MODE);
	
	// variables to store the value of X, Y, Z axis for each read of FIFO.
	static float accelX, accelY, accelZ, totalX, totalY, totalZ;
	// Count variable to count the number of samples counted.
	uint16_t count=0;
	
#ifdef SINGLE_SHOT_MODE  
	while(1){
		// currently working on 26Hz frequency. Set the delay accordingly.
		delay(1);
		status_reg();
		get_accel_rate();
		read_burst_data(&lsm6ds33_sensor_data);
		print_data(&lsm6ds33_sensor_data);
	}
#endif

#ifdef FIFO_MODE
/**
 * @brief  Using the FIFO mode. Still some things needs to be done! 
 * @note   Check for the decimation rate and the ODR.
 * @retval 
 */

	while(1){
		printk("Waiting for watermark...\nIf you want to see some changes in the readings change the orientation of the board right now!!!\n");

		//  Check if the FIFO_FULL Flag is set or not.
		while((lsm6ds33_fifo_status() & FIFO_FULL) == 0) { };
		// This will be a new value everytime to make them 0.
		count=0;
		totalX=0;
		totalY=0;
		totalZ=0;
		while( (lsm6ds33_fifo_status()& FIFO_EMPTY) == 0){
			// Get the X axis data and add it to the total
			accelX = lsm6ds33_fifo_get_accel_data(lsm6ds33_fifo_read());
			totalX +=accelX;
			printk("AccelX_Raw: %f\n", accelX);
			// Get the Y axis data and add it to the total
			accelY = lsm6ds33_fifo_get_accel_data(lsm6ds33_fifo_read());
			totalY +=accelY;
			printk("AccelY_Raw: %f\n", accelY);
			// Get the Z axis data and add it to the total
			accelZ = lsm6ds33_fifo_get_accel_data(lsm6ds33_fifo_read());
			totalZ +=accelZ;
			printk("AccelZ_Raw: %f\n", accelZ);
			count++;
			// printk("AccelX_Raw: %f\n", lsm6ds33_fifo_get_accel_data(lsm6ds33_fifo_read()));
			// printk("AccelY_Raw: %f\n", lsm6ds33_fifo_get_accel_data(lsm6ds33_fifo_read()));
			// printk("AccelZ_Raw: %f\n", lsm6ds33_fifo_get_accel_data(lsm6ds33_fifo_read()));
			delay(50);
		}
		// Print the current data.
		printk("Average count [%d]: %f\t %f\t %f\n", count, totalX/count, totalY/count, totalZ/count);
		lsm6ds33_fifo_change_mode(0);

		lsm6ds33_fifo_change_mode(1);

	}
#endif
		
	return;
}
```

## src/lsm6ds33.c
```c
#include "lsm6ds33.h"

// Device struct to get device binding for I2C
const struct device *dev_i2c;

// Buffer to hold the 16-bit data for each paramter in gyroscope and accel.
int16_t data_buffer[7];	
float temperature_sensitivity = 256.0;
float accel_scale_4_G = 0.122;
float gyro_scale_1000_dps = 35.0;
fifo_t setting;


void check_device(void){
	uint8_t device_id=0;
	i2c_reg_read_byte(dev_i2c, LSM6DS_ADDR, 0X0F, &device_id);
	if(device_id == DEV_ID)
		printk("LSM6DS33 device found!\n");
}

/**
 * @FUNCTION: This function sets the CTRL1_XL register on the sensor to get the accel data rate to 26Hz and 4G data range.
 */
void set_acc_data_rate_range(void){
	int ret = i2c_reg_write_byte(dev_i2c, LSM6DS_ADDR, CTRL1_XL, ACC_26_HZ_4G); 	
	if(ret != 0)
		printk("Error while setting the ACC_range!\n");
	return;
}

/**
 * @FUNCTION: This function sets the CTRL2_G register on the sensor to get the accel data rate to 26Hz and 1000dps data range.
 */
void set_gyro_data_rate_range(void){
	int ret = i2c_reg_write_byte(dev_i2c, LSM6DS_ADDR, CTRL2_G, GYRO_26_HZ_1000dps); 	
	if(ret!=0)
		printk("Error while setting the gyro_range!\n");
	return;
}

/**
 * @FUNCTION: This function pools the status of the sensor by reading the status register.
 */
void status_reg(void){
	uint8_t status=0;
	int ret = i2c_reg_read_byte(dev_i2c, LSM6DS_ADDR, STATUS_REG_LSM, &status);
	if(ret!=0)
		printk("Error reading the status of the register\n");
	printk("Status: %d\n", status);
	return;
}

/**
 * @brief  Get the CTRL1_Xl register and we can infer the frequency and sensitivity of the data collected.
 * @note   
 * @retval None
 */
void get_accel_rate(void){
	uint8_t rate=0;
	int ret = i2c_reg_read_byte(dev_i2c, LSM6DS_ADDR, CTRL1_XL, &rate);
	if(ret!=0)
		printk("Error reading the status of the register\n");
	printk("Rate: 0x%x\n", rate);
	return;
}

/**
 * @brief  Set the power mode for Accelerometer.
 * @note   
 * @param  *data: 
 * @retval None
 */
void accel_set_power_mode(uint8_t power){
	int ret = i2c_reg_write_byte(dev_i2c, LSM6DS_ADDR, CTRL6_ACCEL, power); 	
	if(ret!=0)
		printk("Error while setting the gyro_range!\n");
	if(power==0){
		printk("High Performance mode set\n");
	}
	else
		printk("Low Power Mode set\n");
	return;
}


/**
 * @brief  Set the power mode for gyro.
 * @note   
 * @param  *data: 
 * @retval None
 */
void gyro_set_power_mode(uint8_t power){
	int ret = i2c_reg_write_byte(dev_i2c, LSM6DS_ADDR, CTRL6_GYRO, power); 	
	if(ret!=0)
		printk("Error while setting the gyro_range!\n");
	if(power==0){
		printk("High Performance mode set\n");
	}
	else
		printk("Low Power Mode set\n");
	return;
}

/**
 * @FUNCTION: This function gets the data from the sensor in bursts.
 */
void read_burst_data(lsm6ds33_t *data){
	uint8_t buffer[14];
	i2c_burst_read(dev_i2c, LSM6DS_ADDR, OUT_TEMP_L, &buffer[0], 14);
	for(int i=0; i<13; i+=2){
		data_buffer[i/2] = buffer[i+1] << 8 | buffer[i];
//		printf("data_buffer[%d] = buffer[%d] << 8 | buffer[%d]\n", i/2, i+1, i);
	}
	data->gyroX = data_buffer[1] * gyro_scale_1000_dps *  SENSORS_DPS_TO_RADS/1000.0;
	data->gyroY = data_buffer[2] * gyro_scale_1000_dps *  SENSORS_DPS_TO_RADS/1000.0;
	data->gyroZ = data_buffer[3] * gyro_scale_1000_dps *  SENSORS_DPS_TO_RADS/1000.0;

	data->accelX = data_buffer[4] * accel_scale_4_G * SENSORS_GRAVITY_STANDARD / 1000.0;
	data->accelY = data_buffer[5] * accel_scale_4_G  *SENSORS_GRAVITY_STANDARD / 1000.0;
	data->accelZ = data_buffer[6] * accel_scale_4_G  *SENSORS_GRAVITY_STANDARD / 1000.0;
	return;
}

void print_data(lsm6ds33_t *data){
	printf("Gyro: %f\t %f\t %f  dps\n",data->gyroX, data->gyroY, data->gyroZ);
	printf("Accel: %f\t %f\t %f\n",data->accelX, data->accelY, data->accelZ);
	return;
}


void lsm6ds33_set_fifo_settings(fifo_t* setting){
	// No Decimation for accelerometer.
	setting->axel_decimation_rate = 1; 
	// Gyroscope FIFO OFF.
	setting->gyro_decimation_rate = 0;
	// 1 -> FIFO mode; 0->Bypass mode; 6->Continuous mode
	setting->mode = 1;
	//1->12Hz; 2->26Hz; 3->52Hz and so on. Pg 42 (9.4)
	setting->sample_rate = 2;
	// Get 130 words and then raise the water mark flag.
	setting->threshold = 1;
	return;
}



void lsm6ds33_init(void){
	// Do the Not FIFO things. 
	set_gyro_data_rate_range();
	set_acc_data_rate_range();
	
#ifdef FIFO_MODE	
	// Set all the settings.
	lsm6ds33_set_fifo_settings(&setting);
	// If this is not included. Need to power off the board after each time you hit the restart button.
	// Basically, required to start out fresh.
	lsm6ds33_fifo_change_mode(0);
	// Set all the registers inside the sensor.
	lsm6ds33_fifo_begin(&setting);
#endif
	return;
}


void lsm6ds33_fifo_begin(fifo_t* setting){
	uint8_t threshold_lsb = (setting->threshold)&0x00FF;
	uint8_t threshold_msb = ((setting->threshold)&0x0F00)>>8;
	uint8_t temp_decimation_rate = (setting->gyro_decimation_rate&0x07)<<3 | (setting->axel_decimation_rate&0x07);
	uint8_t temp_odr_mode=(setting->sample_rate&0x0F)<<3 | (setting->mode&0x07);

	uint8_t stop_on_FTH = 1;

	// printk("final_decimation_rate=%d\n", temp_decimation_rate);
	// printk("Final_mode and odr: %d\n", temp_ctrl5);
	// printk("Threshold LSB: %d\n", threshold_lsb);
	// printk("Threshold MSB: %d\n", threshold_msb);

	// Set the LSB of the threshold register.
	i2c_reg_write_byte(dev_i2c, LSM6DS_ADDR, FIFO_CTRL1, threshold_lsb);
	// Set the MSB of the threshold register.
	i2c_reg_write_byte(dev_i2c, LSM6DS_ADDR, FIFO_CTRL2, threshold_msb);
	// Set the decimation rate of the gyroscope and accelerometer.
	i2c_reg_write_byte(dev_i2c, LSM6DS_ADDR, FIFO_CTRL3, temp_decimation_rate);
	// Set the ODR rate and FIFO Mode of the sensor.
	i2c_reg_write_byte(dev_i2c, LSM6DS_ADDR, FIFO_CTRL5, temp_odr_mode);
	// Set the 0th bit in the CTRL4_C register to make sure we stop taking samples once the water mark flag is set.
	i2c_reg_write_byte(dev_i2c, LSM6DS_ADDR, CTRL4_C, stop_on_FTH);
}


uint16_t lsm6ds33_fifo_status(void){
	uint8_t buffer[2]; 
	uint16_t tempAcc=0;
	i2c_burst_read(dev_i2c, LSM6DS_ADDR, FIFO_STATUS1, &buffer[0], 2);
	tempAcc = (buffer[1]<<8) | (buffer[0]);
	// printk("Inside status MSB: %d\n", tempAcc);
	return tempAcc;

}

uint16_t lsm6ds33_fifo_read(void){
	uint8_t buffer[2];
	// read the first 16 bits of data and send it as return value.
	i2c_burst_read(dev_i2c, LSM6DS_ADDR, FIFO_DATA_OUT_L, &buffer[0], 2);
	uint16_t tempAcc =(uint16_t)((buffer[1]<<8) | (buffer[0]));

	return tempAcc;
}

void lsm6ds33_fifo_clear(void){
	// The last fourth bit of the returned value will be FIFO_EMPTY flag. Check the flag until we reach it. 
	while((lsm6ds33_fifo_status() &0x1000) == 0){
		lsm6ds33_fifo_read();
		// printk("Clearing FiFO\n");
	}
	return;
}

void lsm6ds33_fifo_change_mode(uint8_t selected_mode){
	if((selected_mode&1) == 0){
		// printk("Setting the bypass mode!!!\n");
		uint8_t temp_ctrl5=(setting.sample_rate&0x0F)<<3 | (selected_mode&0x07);
		i2c_reg_write_byte(dev_i2c, LSM6DS_ADDR, FIFO_CTRL5, temp_ctrl5);
	}
	else{
		selected_mode=1;
		uint8_t temp_ctrl5=(setting.sample_rate&0x0F)<<3 | (selected_mode&0x07);
		i2c_reg_write_byte(dev_i2c, LSM6DS_ADDR, FIFO_CTRL5, temp_ctrl5);
	}

}

void set_bdu_bit(void){
	uint8_t temp = 1<<6;
	i2c_reg_write_byte(dev_i2c,LSM6DS_ADDR, CTRL3_C, temp);
	return;
}

float lsm6ds33_fifo_get_gyro_data(uint16_t data){
	float temp = data * gyro_scale_1000_dps *  SENSORS_DPS_TO_RADS/1000.0;
	return temp;
}

float lsm6ds33_fifo_get_accel_data(int16_t data){
	float temp = (float)data * accel_scale_4_G * SENSORS_GRAVITY_STANDARD / 1000.0;
	return temp;
}
```

## src/lsm6ds33.h
```c
#ifndef LSM6DS33_H
#define LSM6DS33_H

#include <stdio.h>
#include <zephyr.h>
#include <sys/printk.h>
#include "uart_i2c.h"

// Address of sensor on I2C bus.
#define LSM6DS_ADDR 0x6A
//  Device ID of the sensor.
#define DEV_ID 105
// Control register for the Accelerometer. Sets ODR and Bandwith. P.47 (9.11)
#define CTRL1_XL 0x10
// Control register for the Gyroscope. Sets ODR and Bandwaith. P.48 (9.12)
#define CTRL2_G 0x11
// Control register 3. Required for BDU. Not necessary to implement. P.48 (9.13)
#define CTRL3_C 0x12
// Control register 4. Set the 0th bit STOP_ON_FTH to stop the FIFO collection when the watermark flag rises. P.49 (9.14)
#define CTRL4_C 0x13
// Status Register. P.56 (9.24)
#define STATUS_REG_LSM 0x1E
// Output Low register for the temperature. Can burst read 14 uint8_t from this register to get all the data. P.57 (9.25)
#define OUT_TEMP_L 0x20
// Output High register for the temperature register.
#define OUT_TMP_H 0x21
// Required to set the high performance mode or low power mode on gyroscope and Acccel.
#define CTRL6_ACCEL 0x15
#define CTRL6_GYRO 0x16

// FIFO Control Registers. Section 9.2-9.6 Datasheet
#define FIFO_CTRL1 0x06 // SET THE THRESHOLD / WATERMARK FLAG
#define FIFO_CTRL2 0x07 // Higher bits for the watermark flag threshold.
#define FIFO_CTRL3 0x08 // Set teh decimation rate for Gyro and Accel. 000->Gyro sensor not on FIFO; 001->No Decimation
#define FIFO_CTRL4 0x09 // Not relevant. Leave as is.
// CTRL5L: Mode: 000->Bypass Mode; 001->FIFO mode; 110->Continuous Mode.
#define FIFO_CTRL5 0x0A // Set FiFO Mode [First 3 bits] and ODR [Next 4 bits.] [0DDDDMMM]
#define FIFO_STATUS1 0x3A // Number of unread words stored in FIFO
#define FIFO_STATUS2 0x3B // Number of unread words stored in FIFO + FTH + FIFO_OVER_RUN + FIFO_FULL
#define FIFO_DATA_OUT_L 0x3E // LSB of the output port of FIFO data
#define FIFO_DATA_OUT_H 0x3F // MSB of the output port of FIFO data


// Bit Mask to set the Low Power Mode for gyro.
#define GYRO_LOW_POWER_MODE 0x80
#define GYRO_HIGH_PERF_MODE 0x00

// Bit Mask to set the Low power mode for accel.
#define ACCEL_LOW_POWER_MODE 0x10
#define ACEEL_HIGH_PERF_MODE 0x00

// Current 26Hz
#define ACC_26_HZ_4G 0x28		// Set gyroscope data rate to 26Hz. Make sure to read the datasheet for this. Also the scale selection is 4G. 2-> 26Hz, 8->4G.
#define GYRO_26_HZ_1000dps 0x28	// Set Accel. data rate to 26Hz. Make sure to read the datasheet for this. Also the scale selection is 1000dps. 2-> 26Hz, 8->1000dps.
// below values can be found on this website: https://github.com/adafruit/Adafruit_Sensor/blob/master/Adafruit_Sensor.h
#define SENSORS_DPS_TO_RADS (0.017453293F)		
#define SENSORS_GRAVITY_STANDARD (9.80665f)


// Define to get the output in the FIFO Mode. Useful to detect vibrations.
#define FIFO_MODE
// Bit mask if the FIFO_FULL flag is set.
#define FIFO_FULL 0x2000
// Bit mask if the FIFO_EMPTY flag is set.
#define FIFO_EMPTY 0x1000

// Structure to hold the Gyroscope and Accelerometer data.
typedef struct lsm6ds33{
	uint16_t temp;
	float gyroX,
		  gyroY,
		  gyroZ, 
		  accelX,
		  accelY,
		  accelZ;
}lsm6ds33_t;

// Structure to hold the setting for FIFO.
typedef struct{
	uint16_t threshold;
	uint16_t sample_rate;
	uint16_t mode;	
	uint8_t gyro_decimation_rate;
	uint8_t axel_decimation_rate;
	
}fifo_t;

void gyro_set_power_mode(uint8_t);
void accel_set_power_mode(uint8_t);
void get_accel_rate(void);
void enable_uart_console(void);
void configure_device(void);
void check_device(void);
void set_acc_data_rate_range(void);
void set_gyro_data_rate_range(void);
void status_reg(void);
void read_burst_data(lsm6ds33_t*);
void print_data(lsm6ds33_t*);
void lsm6ds33_init(void);

// FIFO helper functions
/**
 * @brief  Set the current setting of the FIFO.
 * @note   
 * @param  setting: Global variable. Each parameter of the setting is changed inside this function.
 * @retval None
 */
void lsm6ds33_set_fifo_settings(fifo_t*);

/**
 * @brief  Begin the FIFO and call the @lsm6ds33_set_fifo_settings function call to set all the settings before calling this function.
 * @note   fifo_t* a FIFO setting struct reference.
 * @retval None
 */
void lsm6ds33_fifo_begin(fifo_t*);

/**
 * @brief  Get the current FIFO status. Reads FIFO_STATUS registers to get the data.
 * @note   
 * @retval Returns a 16bit value which possess data out of FIFO_STATUS1 & FIFO_STATUS2 register.
 */
uint16_t lsm6ds33_fifo_status(void);

/**
 * @brief  Read 2 bytes from the fifo. Gets Raw data out of the FIFO_DATA_OUT_L & FIFO_DATA_OUT_H registers.
 * @note   
 * @retval Returns a word with the current fifo data.
 */
uint16_t lsm6ds33_fifo_read(void);

/**
 * @brief  Clears the content of the FIFO. Reads the data until FIFO_EMPTY flag is set.
 * @note   
 * @retval None
 */
void lsm6ds33_fifo_clear(void);

/**
 * @brief  Processes the raw data and returns a human readable format of the gyroscope data.
 * @note   
 * @retval Float processed value of the raw gyroscope data.
 */
float lsm6ds33_fifo_get_gyro_data(uint16_t);

/**
 * @brief  Processes the raw data and returns a human readable format of the accelerometer data.
 * @note   
 * @retval Float Processed value of the raw accelerometer data.
 */
float lsm6ds33_fifo_get_accel_data(int16_t);

/**
 * @brief  Change the current mode of the data. 
 * @param uint8_t 0-> bypassmode; otherwise->FIFO_Mode
 * @note   
 * @retval None
 */
void lsm6ds33_fifo_change_mode(uint8_t);


#endif
```

## src/uart_i2c.h
```c
#ifndef UART_I2C_H
#define UART_I2C_H 

#include <device.h>
#include <drivers/i2c.h>
#include <usb/usb_device.h>
#include <drivers/uart.h>
#define I2C_DEV "I2C_0"

#define delay(x)    k_sleep(K_MSEC(x))

extern const struct device *dev_i2c;

void enable_uart_console(void);
void configure_device(void);

#endif
```
