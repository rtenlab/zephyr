## prj.conf
```kconfig
CONFIG_GPIO=y

CONFIG_USB_DEVICE_PRODUCT="Zephyr USB Console Sample"
CONFIG_USB_DEVICE_STACK=y
CONFIG_USB_UART_CONSOLE=y

CONFIG_UART_INTERRUPT_DRIVEN=y
CONFIG_UART_LINE_CTRL=y
CONFIG_UART_CONSOLE_ON_DEV_NAME="CDC_ACM_0"

CONFIG_FPU=y
```

## src/main.c
```c
/*
 * Copyright (c) 2016 Intel Corporation
 *
 * SPDX-License-Identifier: Apache-2.0
 */

#include "uart_i2c.h"
#include <zephyr.h>
#include <device.h>
#include <devicetree.h>
#include <stdio.h>
#include <drivers/gpio.h>
#include "sht31.h"
#include "Onewire.h"
#include "Dallas_temperature.h"

extern const struct device *dev_ds18b20;

void main(void)
{
	
	int ret;
	enable_uart_console();
	configure_device();

	dev_ds18b20 = device_get_binding(DS_SENSOR);
	if (dev_ds18b20 == NULL) {
		return;
	}

	ret = gpio_pin_configure(dev_ds18b20, DS_SENSOR_PIN, GPIO_OUTPUT);
	if (ret < 0) {
		return;
	}

	{
		volatile int n_devices;
		sht31_t sht31_data;
		DallasTemperature_begin();		
		uint8_t address[8];
		n_devices = getDeviceCount();

		while (1) {
			
			read_temp_hum(&sht31_data);
			print_data_sht(&sht31_data);
			requestTemperatures();
			printf("Total devices: %d\n", n_devices);
			for (int i = 0; i < n_devices; i++) {
				if(getAddress(address, i)==false){
					printk("Problem with getAddress thing!\n");
				}
				printf("0x");
				for(int ii=0; ii<8; ii++){
					printf("%x", address[ii]);
				}
				printf("\nsensor %d: %f\n", i, getTempCByIndex(i));
			}
			k_msleep(4000);
		}
	}
}
```

## src/Dallas_temperature.c
```c
#include "Dallas_temperature.h"

// parasite power on or off
bool parasite;

// external pullup
bool useExternalPullup;
uint8_t pullupPin;

// used to determine the delay amount needed to allow for the
// temperature conversion to take place
uint8_t bitResolution;

// used to requestTemperature with or without delay
bool waitForConversion;

// used to requestTemperature to dynamically check if a conversion is complete
bool checkForConversion;

// used to determine if values will be saved from scratchpad to EEPROM on every scratchpad write
bool autoSaveScratchPad;

// count of devices on the bus
uint8_t devices;

// count of DS18xxx Family devices on bus
uint8_t ds18Count;


extern const struct device *dev_ds18b20;
bool validFamily(const uint8_t* deviceAddress) {
	switch (deviceAddress[DSROM_FAMILY]) {
	case DS18S20MODEL:
	case DS18B20MODEL:
	case DS1822MODEL:
	case DS1825MODEL:
	case DS28EA00MODEL:
		return true;
	default:
		return false;
	}
}


uint8_t getResolution(const uint8_t* deviceAddress) {

	// DS1820 and DS18S20 have no resolution configuration register
	if (deviceAddress[DSROM_FAMILY] == DS18S20MODEL)
		return 12;

	ScratchPad scratchPad;
	if (isConnected(deviceAddress, scratchPad)) {
		switch (scratchPad[CONFIGURATION]) {
		case TEMP_12_BIT:
			return 12;

		case TEMP_11_BIT:
			return 11;

		case TEMP_10_BIT:
			return 10;

		case TEMP_9_BIT:
			return 9;
		}
	}
	return 0;

}

bool isAllZeros(const uint8_t * const scratchPad) {
	const size_t length = 9;
	for (size_t i = 0; i < length; i++) {
		if (scratchPad[i] != 0) {
			return false;
		}
	}

	return true;
}

bool readScratchPad(const uint8_t* deviceAddress, uint8_t* scratchPad) {

	// send the reset command and fail fast
	int b = reset();
	if (b == 0)
		return false;

	select(deviceAddress);
	write(READSCRATCH);

	// Read all registers in a simple loop
	// byte 0: temperature LSB
	// byte 1: temperature MSB
	// byte 2: high alarm temp
	// byte 3: low alarm temp
	// byte 4: DS18S20: store for crc
	//         DS18B20 & DS1822: configuration register
	// byte 5: internal use & crc
	// byte 6: DS18S20: COUNT_REMAIN
	//         DS18B20 & DS1822: store for crc
	// byte 7: DS18S20: COUNT_PER_C
	//         DS18B20 & DS1822: store for crc
	// byte 8: SCRATCHPAD_CRC
	for (uint8_t i = 0; i < 9; i++) {
		scratchPad[i] = read();
	}

	b = reset();
	return (b == 1);
}

bool isConnected(const uint8_t* deviceAddress, uint8_t* scratchPad) {
	bool b = readScratchPad(deviceAddress, scratchPad);
	return b && !isAllZeros(scratchPad);
}

uint8_t getDeviceCount(void) {
	return devices;
}

void DallasTemperature_begin(void) {
	DeviceAddress deviceAddress;

	reset_search();
	devices = 0; // Reset the number of devices when we enumerate wire devices
	ds18Count = 0; // Reset number of DS18xxx Family devices

	while (search(deviceAddress)) {

		devices++;

		if (validFamily(deviceAddress)) {
			ds18Count++;

			uint8_t b = getResolution(deviceAddress);
			if (b > bitResolution) bitResolution = b;
		}
	}
}



bool isConversionComplete(void) {
	uint8_t b = read_bit();
	return (b == 1);
}

uint16_t millisToWaitForConversion(uint8_t bitResolution) {

	switch (bitResolution) {
	case 9:
		return 94;
	case 10:
		return 188;
	case 11:
		return 375;
	default:
		return 750;
	}

}

void activateExternalPullup(void) {
	if(useExternalPullup)
		//digitalWrite(pullupPin, LOW);
		gpio_pin_set(dev_ds18b20,LED1_PIN,LOW);
}

void deactivateExternalPullup(void) {
	if(useExternalPullup)
		//digitalWrite(pullupPin, HIGH);
		gpio_pin_set(dev_ds18b20,LED1_PIN,HIGH);
}

void blockTillConversionComplete(uint8_t bitResolution) {

  if (checkForConversion) {
	for (int i = 0; i < MAX_CONVERSION_TIMEOUT; i++) {
		if (isConversionComplete()) break;
		k_msleep(1);
	}
  } else {
    unsigned long delms = millisToWaitForConversion(bitResolution);
    activateExternalPullup();
    k_msleep(delms);
    deactivateExternalPullup();
  }

}

void requestTemperatures(void) {

	reset();
	skip();
	write(STARTCONVO);

	// ASYNC mode?
	if (!waitForConversion)
		return;
	blockTillConversionComplete(bitResolution);

}

bool getAddress(uint8_t* deviceAddress, uint8_t index) {

	uint8_t depth = 0;

	reset_search();

	while (depth <= index && search(deviceAddress)) {
		if (depth == index)
			return true;
		depth++;
	}

	return false;

}

int16_t calculateTemperature(const uint8_t* deviceAddress,
		uint8_t* scratchPad) {

	int16_t fpTemperature = (((int16_t) scratchPad[TEMP_MSB]) << 11)
			| (((int16_t) scratchPad[TEMP_LSB]) << 3);

	/*
	 DS1820 and DS18S20 have a 9-bit temperature register.
	 Resolutions greater than 9-bit can be calculated using the data from
	 the temperature, and COUNT REMAIN and COUNT PER °C registers in the
	 scratchpad.  The resolution of the calculation depends on the model.
	 While the COUNT PER °C register is hard-wired to 16 (10h) in a
	 DS18S20, it changes with temperature in DS1820.
	 After reading the scratchpad, the TEMP_READ value is obtained by
	 truncating the 0.5°C bit (bit 0) from the temperature data. The
	 extended resolution temperature can then be calculated using the
	 following equation:
	                                  COUNT_PER_C - COUNT_REMAIN
	 TEMPERATURE = TEMP_READ - 0.25 + --------------------------
	                                         COUNT_PER_C
	 Hagai Shatz simplified this to integer arithmetic for a 12 bits
	 value for a DS18S20, and James Cameron added legacy DS1820 support.
	 See - http://myarduinotoy.blogspot.co.uk/2013/02/12bit-result-from-ds18s20.html
	 */

	if ((deviceAddress[DSROM_FAMILY] == DS18S20MODEL) && (scratchPad[COUNT_PER_C] != 0)) {
		fpTemperature = ((fpTemperature & 0xfff0) << 3) - 32
				+ (((scratchPad[COUNT_PER_C] - scratchPad[COUNT_REMAIN]) << 7)
						/ scratchPad[COUNT_PER_C]);
	}

	return fpTemperature;
}

// returns temperature in 1/128 degrees C or DEVICE_DISCONNECTED_RAW if the
// device's scratch pad cannot be read successfully.
// the numeric value of DEVICE_DISCONNECTED_RAW is defined in
// DallasTemperature.h. It is a large negative number outside the
// operating range of the device
int16_t getTemp(const uint8_t* deviceAddress) {

	ScratchPad scratchPad;
	if (isConnected(deviceAddress, scratchPad))
		return calculateTemperature(deviceAddress, scratchPad);
	return DEVICE_DISCONNECTED_RAW;

}

float rawToCelsius(int16_t raw) {

	if (raw <= DEVICE_DISCONNECTED_RAW)
		return DEVICE_DISCONNECTED_C;
	// C = RAW/128
	return (float) raw * 0.0078125f;

}


// returns temperature in degrees C or DEVICE_DISCONNECTED_C if the
// device's scratch pad cannot be read successfully.
// the numeric value of DEVICE_DISCONNECTED_C is defined in
// DallasTemperature.h. It is a large negative number outside the
// operating range of the device
float getTempC(const uint8_t* deviceAddress) {
	return rawToCelsius(getTemp(deviceAddress));
}

float getTempCByIndex(uint8_t deviceIndex) {

	DeviceAddress deviceAddress;
	if (!getAddress(deviceAddress, deviceIndex)) {
		return DEVICE_DISCONNECTED_C;
	}
	return getTempC((uint8_t*) deviceAddress);
}
```

## src/Onewire.c
```c
#include "Onewire.h"

unsigned char ROM_NO[8];
uint8_t LastDiscrepancy;
uint8_t LastFamilyDiscrepancy;
bool LastDeviceFlag;

const struct device *dev_ds18b20;

static inline void udelay(int secs){
	k_busy_wait(secs);
}


uint8_t reset(void){
	int key = irq_lock();
	uint8_t r;
	gpio_pin_configure(dev_ds18b20, DS_SENSOR_PIN, GPIO_OUTPUT);
	gpio_pin_set(dev_ds18b20,DS_SENSOR_PIN,LOW);
	udelay(480);
	gpio_pin_set(dev_ds18b20,DS_SENSOR_PIN,HIGH);
	udelay(70);
	// while((gpio_pin_get(dev_ds18b20,DS_SENSOR_PIN))!=0){
	// 	r = gpio_pin_get(dev_ds18b20,DS_SENSOR_PIN);
	// 	printk("stuck in teh while loopwith value of r: %d\n",r);
	// }
	gpio_pin_configure(dev_ds18b20, DS_SENSOR_PIN, GPIO_INPUT);
	r = gpio_pin_get(dev_ds18b20,DS_SENSOR_PIN);
	udelay(410);
	irq_unlock(key);
	return !r;
}

uint8_t read_bit(void){
	uint8_t r;
	int key = irq_lock();
	gpio_pin_configure(dev_ds18b20, DS_SENSOR_PIN, GPIO_OUTPUT);
	gpio_pin_set(dev_ds18b20,DS_SENSOR_PIN,LOW);
	udelay(3);
	// gpio_pin_set(dev_ds18b20,DS_SENSOR_PIN,HIGH);
	gpio_pin_configure(dev_ds18b20, DS_SENSOR_PIN, GPIO_INPUT);
	udelay(10);	
	r = gpio_pin_get(dev_ds18b20,DS_SENSOR_PIN);
	irq_unlock(key);
	udelay(53);
	return r;
}

uint8_t read(void){
	uint8_t bitMask;
	uint8_t r = 0;
	for(bitMask=0x01; bitMask;bitMask<<=1){
		if(read_bit()){
			r|=bitMask;
			// udelay(1);
		}
	}
	return r;
}

void write_bit(uint8_t v){
	// printk("Outputting bit: %d\n",v);
	if(v&1){
		int key = irq_lock();
		gpio_pin_set(dev_ds18b20,DS_SENSOR_PIN,LOW);
		gpio_pin_configure(dev_ds18b20, DS_SENSOR_PIN, GPIO_OUTPUT);
		udelay(10);
		gpio_pin_set(dev_ds18b20,DS_SENSOR_PIN,HIGH);
		irq_unlock(key);
		udelay(55);
	}
	else{
		int key = irq_lock();
		gpio_pin_set(dev_ds18b20,DS_SENSOR_PIN,LOW);
		gpio_pin_configure(dev_ds18b20, DS_SENSOR_PIN, GPIO_OUTPUT);
		udelay(65);
		gpio_pin_set(dev_ds18b20,DS_SENSOR_PIN,HIGH);
		irq_unlock(key);
		udelay(5);
	}
	return;	
}

void write(uint8_t v){
	uint8_t bitMask;
	for(bitMask = 0x01; bitMask; bitMask<<=1){
		write_bit((bitMask&v)?1:0);
		// udelay(1);
	}
	return;
}

bool search(uint8_t *newAddr)
{
   bool search_mode = true;
   uint8_t id_bit_number;
   uint8_t last_zero, rom_byte_number;
   bool    search_result;
   uint8_t id_bit, cmp_id_bit;

   unsigned char rom_byte_mask, search_direction;

   // initialize for search
   id_bit_number = 1;
   last_zero = 0;
   rom_byte_number = 0;
   rom_byte_mask = 1;
   search_result = false;

   // if the last call was not the last one
   if (!LastDeviceFlag) {
      // 1-Wire reset
      if (!reset()) {
         // reset the search
         LastDiscrepancy = 0;
         LastDeviceFlag = false;
         LastFamilyDiscrepancy = 0;
         return false;
      }

      // issue the search command
      if (search_mode == true) {
        write(0xF0);   // NORMAL SEARCH
      } else {
        write(0xEC);   // CONDITIONAL SEARCH
      }

      // loop to do the search
      do
      {
         // read a bit and its complement
         id_bit = read_bit();
         cmp_id_bit = read_bit();

         // check for no devices on 1-wire
         if ((id_bit == 1) && (cmp_id_bit == 1)) {
            break;
         } else {
            // all devices coupled have 0 or 1
            if (id_bit != cmp_id_bit) {
               search_direction = id_bit;  // bit write value for search
            } else {
               // if this discrepancy if before the Last Discrepancy
               // on a previous next then pick the same as last time
               if (id_bit_number < LastDiscrepancy) {
                  search_direction = ((ROM_NO[rom_byte_number] & rom_byte_mask) > 0);
               } else {
                  // if equal to last pick 1, if not then pick 0
                  search_direction = (id_bit_number == LastDiscrepancy);
               }
               // if 0 was picked then record its position in LastZero
               if (search_direction == 0) {
                  last_zero = id_bit_number;

                  // check for Last discrepancy in family
                  if (last_zero < 9)
                     LastFamilyDiscrepancy = last_zero;
               }
            }

            // set or clear the bit in the ROM byte rom_byte_number
            // with mask rom_byte_mask
            if (search_direction == 1)
              ROM_NO[rom_byte_number] |= rom_byte_mask;
            else
              ROM_NO[rom_byte_number] &= ~rom_byte_mask;

            // serial number search direction write bit
            write_bit(search_direction);

            // increment the byte counter id_bit_number
            // and shift the mask rom_byte_mask
            id_bit_number++;
            rom_byte_mask <<= 1;

            // if the mask is 0 then go to new SerialNum byte rom_byte_number and reset mask
            if (rom_byte_mask == 0) {
                rom_byte_number++;
                rom_byte_mask = 1;
            }
         }
      }
      while(rom_byte_number < 8);  // loop until through all ROM bytes 0-7

      // if the search was successful then
      if (!(id_bit_number < 65)) {
         // search successful so set LastDiscrepancy,LastDeviceFlag,search_result
         LastDiscrepancy = last_zero;

         // check for last device
         if (LastDiscrepancy == 0) {
            LastDeviceFlag = true;
         }
         search_result = true;
      }
   }

   // if no device found then reset counters so next 'search' will be like a first
   if (!search_result || !ROM_NO[0]) {
      LastDiscrepancy = 0;
      LastDeviceFlag = false;
      LastFamilyDiscrepancy = 0;
      search_result = false;
   } else {
      for (int i = 0; i < 8; i++) newAddr[i] = ROM_NO[i];
   }
   return search_result;
}

void select(const uint8_t rom[8])
{
    uint8_t i;

    write(0x55);           // Choose ROM

    for (i = 0; i < 8; i++) write(rom[i]);
}

void reset_search(void)
{
  // reset the search state
  LastDiscrepancy = 0;
  LastDeviceFlag = false;
  LastFamilyDiscrepancy = 0;
  for(int i = 7; ; i--) {
    ROM_NO[i] = 0;
    if ( i == 0) break;
  }
}
void skip()
{
    write(0xCC);           // Skip ROM
}
```

## src/Onewire.h
```c
#ifndef ONEWIRE_H
#define ONEWIRE_H


#include <zephyr.h>
#include <device.h>
#include <devicetree.h>
#include <stdio.h>
#include <drivers/gpio.h>

/* The devicetree node identifier for the "led2" alias. */
#define DS_NODE DT_ALIAS(ds0)

#if DT_NODE_HAS_STATUS(DS_NODE, okay)
#define DS_SENSOR	        DT_GPIO_LABEL(DS_NODE, gpios)
#define DS_SENSOR_PIN		DT_GPIO_PIN(DS_NODE, gpios)
#define DS_SENSOR_FLAGS	    DT_GPIO_FLAGS(DS_NODE, gpios)
#else
/* A build error here means your board isn't set up to blink an LED. */
#error "Unsupported board: led1 devicetree alias is not defined"
#define DS_SENSOR	        ""
#define DS_SENSOR_PIN	0
#define DS_SENSOR_FLAGS	    0
#endif
#define LOW 0
#define HIGH 1


#define ONEWIRE_SEARCH 1
#define ONEWIRE_CRC 0

// global search state
extern unsigned char ROM_NO[8];
extern uint8_t LastDiscrepancy;
extern uint8_t LastFamilyDiscrepancy;
extern bool LastDeviceFlag;

// /**
//  * @brief  uses k_busy_wait() function to busy wait for inputed microseconds
//  * @param  secs: microseconds for which we need to wait.
//  * @retval None
//  */
// static inline void udelay(int);
/**
 * @brief: Send a reset signal to the DS18B20 sensor. 
 *          Pull the bus low for 480 microseconds and pull up for 70 microseconds.
 * @retval: Checks if the any sensor on the bus acknowledge. 
 *          Returns 1 if acknowledge by the sensor on the bus, else returns 0.
 */
uint8_t reset(void);

/**
 * @brief  Read a single bit from the bus. 
 *          PUll sht ebus low for minimum 1 us and let it float for 10 us. read the input after the sequence.
 * @retval Returns a bit read from the bus.
 */
uint8_t read_bit(void);

/**
 * @brief  Read a byte from the bus.
 *          Use read_bit() functions 8 times and start filling a 8-bit variable from LSB to MSB.
 * @retval Returns a 1 Byte variable obtained from the bus.
 */
uint8_t read(void);

/**
 * @brief  Writes a bit to the bus.
 * @param  1 bit required to be written to the bus.
 * @retval None
 */
void write_bit(uint8_t);

/**
 * @brief  Write 1 Byte (8-bits) to the bus.
 * @param  v: 1 byte that needs to be written to the bus.
 * @retval None
 */
void write(uint8_t);

/**
 * @brief  Look for the next device.
 * @param  Address required to search for the next device on the bus.
 * @retval Returns 1 if a new address has been returned. A zero might mean that the bus is shorted, there are
     no devices, or you have already retrieved all of them.
 */
bool search(uint8_t *);

/**
 * @brief Issue a 1-Wire rom select command, you do the reset first.  
 * @param  uint8_t[8]: The ROM code that needs to be selected
 * @retval None
 */
void select(const uint8_t*);

/**
 * @brief  Clear the search state so that if will start from the beginning again.
 * @retval None
 */
void reset_search(void);

/**
 * @brief  Issue a 1-Wire rom skip command, to address all Sensors on bus.
 * @retval None
 */
void skip(void);

#endif
```
