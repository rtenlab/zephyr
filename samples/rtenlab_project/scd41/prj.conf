## prj.conf
```kconfig
CONFIG_PRINTK=y
CONFIG_I2C=y

CONFIG_I2C_NRFX=y
CONFIG_I2C_0=y
CONFIG_NRFX_TWI=y
CONFIG_NRFX_TWI0=y
CONFIG_NRFX_TWI1=y

CONFIG_USB_DEVICE_PRODUCT="Zephyr USB Console Sample"
CONFIG_USB_DEVICE_STACK=y
CONFIG_USB_UART_CONSOLE=y

CONFIG_UART_INTERRUPT_DRIVEN=y
CONFIG_UART_LINE_CTRL=y
CONFIG_UART_CONSOLE_ON_DEV_NAME="CDC_ACM_0"

CONFIG_FPU=y
CONFIG_CORTEX_M_DWT=n
CONFIG_TIMING_FUNCTIONS=y
```

## overlay-nrf52.conf
```kconfig
CONFIG_I2C_NRFX=y
CONFIG_I2C_0=y
```

## src/main.c
```c
/*
 * SPDX-License-Identifier: Apache-2.0
 * Adapted from https://devzone.nordicsemi.com/f/nordic-q-a/70098/i2c-twi-master-config-on-zephyr.
 * Reference library: https://github.com/Sensirion/embedded-i2c-scd4x
 * Adafruit I2C support library: https://github.com/adafruit/Adafruit_BusIO
 * Zephyr I2C documentation: https://docs.zephyrproject.org/latest/reference/peripherals/i2c.html
 */


/** 
 * Cable configuration:
 * Green-cable: SDA
 * Red cable: VDD
 * Yellow cable: SCL
 * Black cable: GND
 * I2C ADDRESS FOR THE SENSOR IS 0X62
 */

/**
 * @file: This app enables the use of SCD41 CO2 Sensor  sensor on zephyr OS.
 */

#include "scd41.h"
#include <timing/timing.h>


void main(void){
	//struct to store the data measured from the sensor.
	scd41_t sensor_data;
	timing_t start_time, stop_time;
	uint64_t total_cycles;
	uint64_t total_ns;


	// enabling uart_console for zephyr.
	enable_uart_console();

	// configuring the i2c device for communication with the sensor.
	configure_device();

	//print the serial id of the sensor.
	get_serial_number();

	// Infinite loop to measure the data from the sensor, every 100ms. Overall latency will be 5103 ms for each loop iteration.
	while(1){
	soc_timing_init();
	soc_timing_start();
	start_time = timing_counter_get();
	measure_single_shot(&sensor_data);
	stop_time = soc_timing_counter_get();
	total_cycles = soc_timing_cycles_get(&start_time, &stop_time);
	total_ns = soc_timing_cycles_to_ns(total_cycles);
	printf("Timing to get the measure single shot: %lld ns\n", total_ns);
	soc_timing_stop();
	print_data_scd(&sensor_data);
	// delay(100);
	}

	return;
}
```

## src/scd41.c
```c
#include "scd41.h"
 
const struct device *dev_i2c; 
      // Device struct to get device binding for I2C
uint16_t SCD41_ADDR = 0x62;		// Address of the Sensor on I2C bus as described by Adafruit website
uint8_t command_to_sensor[NUM_BYTES_TO_SENSOR];



/**
 * FUNCTION: function to get the crc checksum for the output command.
 * Adapted from Sensirion lbrary: https://github.com/Sensirion/embedded-i2c-scd4x
 */
/* calculates 8-Bit checksum with given polynomial */
uint8_t generate_crc(const uint8_t* data, uint16_t count) {
    uint16_t current_byte;
    uint8_t crc = CRC8_INIT;
    uint8_t crc_bit;
    for (current_byte = 0; current_byte < count; ++current_byte) {
    crc ^= (data[current_byte]);
    for (crc_bit = 8; crc_bit > 0; --crc_bit) {
    if (crc & 0x80)
    crc = (crc << 1) ^ CRC8_POLYNOMIAL;
    else
    crc = (crc << 1);
    }
    }
    return crc;
}


/**
 * @FUNCTION: Function to format the output command that needs to be sent to sensor.
 */
void get_formatted_command(uint16_t command){
	//printf("Preparing 0x%x command to the global buffer!!!\n", command);
	command_to_sensor[0] = (uint8_t)((command & 0xFF00) >> 8);
	command_to_sensor[1] = (uint8_t)((command & 0x00FF) >> 0);
	uint8_t crc = generate_crc(&command_to_sensor[0],2);
	command_to_sensor[2] = crc;	
	return;
}


/**
 * @FUNCTION: function to get the serial number of the sensor.
 */
void get_serial_number(void){
	uint8_t data[9];			// temporary buffer to store the data from the sensor.
	uint16_t serial[3];			// buffer to store just the serial number, excluding crc check.
	get_formatted_command((uint16_t)GET_SERIAL_NUMBER);		// prepares output command in a buffer with the CRC check.
	int ret = i2c_write(dev_i2c, &command_to_sensor[0], NUM_BYTES_TO_SENSOR, SCD41_ADDR);	// write the command prepared in the previous function call to the sensor device. 

	if(ret!=0)
		printf("Error while writing to the device: %d\n", ret);
	delay(3);					//wait for 3 Msec for the sensor to process the command.
	ret = i2c_read(dev_i2c, &data[0],9, SCD41_ADDR);		//read the data sent from the sensor including crc checksum bits.

	if(ret !=0)
		printf("Error while reading from the device: %d\n", ret);
	
	// Get the 3 words in different 16 bit entries in serial.
	serial[0] = data[0] <<8 | data[1];
	serial[1] = data[3] << 8 | data[4];
	serial[2] = data[6] << 8 | data[7];

	//print the output data.
	printf("Correct Serial ID: 0x%4X%4X%4X\n",serial[0],serial[1], serial[2]);

	return;
}

/**
 * FUNCTION: function to read the measured data from the sensor.
 */ 
void read_sensor_data(uint8_t *data, int num_bins_to_read){
	// Command to notify sensor requirement of data.
	get_formatted_command((uint16_t)READ_MEASUREMENT);
	i2c_write(dev_i2c, &command_to_sensor[0], NUM_BYTES_TO_SENSOR, SCD41_ADDR);
	delay(3);
	// Read 9 bytes of data. In order: CO2 -> Tempreature -> humidity.
	i2c_read(dev_i2c, data, num_bins_to_read, SCD41_ADDR);
	return;
}

/**
 * FUNCTION: function to measure data once from the sensor.
 */
void measure_single_shot(scd41_t* data){
	// buffers to store the incoming data from the sensor.
	uint8_t data_buffer[9];
	uint16_t format_data=0;
	// Command to notify sensor to measure data just once.
	get_formatted_command((uint16_t)MEASURE_SINGLE_SHOT);
	i2c_write(dev_i2c, &command_to_sensor[0], NUM_BYTES_TO_SENSOR, SCD41_ADDR);
	//delay of 5 sec for the sensor to get data.
	delay(5000);
	// function call to read 9 bytes of data from the sensor.
	read_sensor_data(&data_buffer[0], 9);
	//store the CO2 data coming from the sensor directly to struct.
	data->Co2 = data_buffer[0] <<8 | data_buffer[1];
	// store the tempreature data coming from the sensor with some modifications as per datasheet.
	format_data = data_buffer[3] << 8 | data_buffer[4]; 
	data->temp = (float)(format_data*175.0/65536.0-45.0);
	// store the humidity data coming from the sensor with some modifications as per datasheet.
	format_data = data_buffer[6] << 8 | data_buffer[7];
	data->hum = (float)(format_data*100.0/65536.0);	
	return;
}

/**
 * FUNCTION: function to print the data obtained from the sensor.
 */
void print_data_scd(scd41_t* data){
    	printf("CO2:%d\t Hum:%f\t Temp: %f\n", data->Co2, data->hum, data->temp);
	return;
}
```

## src/scd41.h
```c
#ifndef SCD41_H
#define SCD41_H

#include<stdio.h>
#include <zephyr.h>
#include <sys/printk.h>
#include "uart_i2c.h"

#define CRC8_POLYNOMIAL 0x31
#define CRC8_INIT 0xFF
#define NUM_BYTES_TO_SENSOR 3
#define READ_MEASUREMENT 0xec05
#define GET_SERIAL_NUMBER 0x3682
#define MEASURE_SINGLE_SHOT 0x219d


// data structure to get the data from the sensor.										
typedef struct data{
	uint16_t Co2;
	float temp, hum;
}scd41_t;


// defining the functions used in the main.c file.
uint8_t generate_crc(const uint8_t*, uint16_t);
void enable_uart_console(void);
void configure_device(void);
void get_formatted_command(uint16_t);
void get_serial_number(void);
void read_sensor_data(uint8_t*, int);
void measure_single_shot(scd41_t*);
void print_data_scd(scd41_t*);
void enable_uart_console(void);
void configure_device(void);
#endif
```

## src/uart_i2c.c
```c
#include "uart_i2c.h"


/**
*@FUNCTION: API to configure the uart console for printk statements.
*/
void enable_uart_console(void){
	const struct device  *dev_usb;																										// Device for USB Console.
	uint32_t dtr=0;
	

	dev_usb = device_get_binding(CONFIG_UART_CONSOLE_ON_DEV_NAME);
	if(usb_enable(NULL))
		return;
	
	while(!dtr)
		uart_line_ctrl_get(dev_usb,UART_LINE_CTRL_DTR, &dtr);	
	  
	return;
}

/**
*@FUNCTION: API to configure the I2C device.
*/
void configure_device(void){
	dev_i2c = device_get_binding(I2C_DEV);
	i2c_configure(dev_i2c, I2C_SPEED_SET(I2C_SPEED_STANDARD));
	if (dev_i2c == NULL) {
		printk("I2C: Device driver not found\n");
	}
	else{
		printk("I2C: Device driver found!!!\n");
	}
	return;
}
```

## src/uart_i2c.h
```c
#ifndef UART_I2C_H
#define UART_I2C_H 
#define I2C_DEV "I2C_0"

#include <device.h>
#include <drivers/i2c.h>
#include <usb/usb_device.h>
#include <drivers/uart.h>

extern const struct device *dev_i2c;
#define delay(x)    k_sleep(K_MSEC(x))

void enable_uart_console(void);
void configure_device(void);

#endif
```
