## prj.conf
```kconfig
CONFIG_BT=y
CONFIG_BT_CENTRAL=y
CONFIG_BT_AUTO_PHY_UPDATE=n
CONFIG_BT_PRIVACY=y

CONFIG_BT_MAX_CONN=62

# CONFIG_BT_GATT_CLIENT=y

# CONFIG_BT_SMP=y
# CONFIG_BT_MAX_PAIRED=62

CONFIG_USB_DEVICE_STACK=y
CONFIG_USB_DEVICE_PRODUCT="Zephyr USB console sample"
CONFIG_USB_UART_CONSOLE=y

CONFIG_UART_INTERRUPT_DRIVEN=y
CONFIG_UART_LINE_CTRL=y
CONFIG_UART_CONSOLE_ON_DEV_NAME="CDC_ACM_0"
```

## src/main.c
```c
/* main.c - Application main entry point */

/*
 * Copyright (c) 2021 Nordic Semiconductor ASA
 *
 * SPDX-License-Identifier: Apache-2.0
 */

int init_central(void);

#include <zephyr/types.h>
#include <stddef.h>
#include <string.h>
#include <sys/printk.h>
#include <sys/util.h>
#include <usb/usb_device.h>
#include <drivers/uart.h>

#include <device.h>
#include <devicetree.h>
#include <drivers/gpio.h>

void main(void)
{const struct device *dev_led, *dev_usb;
        int err;


        /* USB serial setup */
  dev_usb = device_get_binding(CONFIG_UART_CONSOLE_ON_DEV_NAME);
        uint32_t dtr = 0;

        if (usb_enable(NULL)) {
                return;
        }

        while (!dtr) {
                uart_line_ctrl_get(dev_usb, UART_LINE_CTRL_DTR, &dtr);
        }

        /* Initialize the Bluetooth Subsystem */
        printk("Starting Beacon Demo\n");
	printk("This is the first changes made by Dev on this platform\n");
	(void)init_central();
}
```
